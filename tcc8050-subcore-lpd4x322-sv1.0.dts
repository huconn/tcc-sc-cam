/dts-v1/;

/ {
	compatible = "telechips,tcc805x";
	interrupt-parent = < 0x01 >;
	#address-cells = < 0x02 >;
	#size-cells = < 0x02 >;
	model = "Telechips TCC8050 LPD4X322 1.0 Sub-Core";
	board-id = < 0x4000 >;
	board-rev = < 0x01 >;

	chosen {
		bootargs = "vmalloc=480M console=ttyAMA4,115200n8";
		stdout-path = "serial4:115200n8,mmio32,0x16640000";
	};

	aliases {
		gpio0 = "/gpio@14200000/gpa";
		gpio32 = "/gpio@14200000/gpb";
		gpio61 = "/gpio@14200000/gpc";
		gpio91 = "/gpio@14200000/gpe";
		gpio111 = "/gpio@14200000/gpg";
		gpio122 = "/gpio@14200000/gph";
		gpio134 = "/gpio@14200000/gpk";
		gpio153 = "/gpio@14200000/gpsd0";
		gpio168 = "/gpio@14200000/gpsd1";
		gpio179 = "/gpio@14200000/gpsd2";
		gpio189 = "/gpio@14200000/gpma";
		gpio219 = "/gpio@14200000/gpmb";
		gpio251 = "/gpio@14200000/gpmc";
		gpio281 = "/gpio@14200000/gpmd";
		serial0 = "/serial@16600000";
		serial1 = "/serial@16610000";
		serial2 = "/serial@16620000";
		serial3 = "/serial@16630000";
		serial4 = "/serial@16640000";
		serial5 = "/serial@16650000";
		serial6 = "/serial@16660000";
		serial7 = "/serial@16670000";
		udma0 = "/udma@16680000";
		udma1 = "/udma@16681000";
		udma2 = "/udma@16682000";
		udma3 = "/udma@16683000";
		udma4 = "/udma@16684000";
		udma5 = "/udma@16685000";
		udma6 = "/udma@16686000";
		udma7 = "/udma@16687000";
		adc = "/adc@1b700000";
		i2c0 = "/i2c@16300000";
		i2c1 = "/i2c@16310000";
		i2c2 = "/i2c@16320000";
		i2c3 = "/i2c@16330000";
		i2c4 = "/i2c@16340000";
		i2c5 = "/i2c@16350000";
		i2c6 = "/i2c@16360000";
		i2c7 = "/i2c@16370000";
		gpsb0 = "/spi@16900000";
		gpsb1 = "/spi@16910000";
		gpsb2 = "/spi@16920000";
		gpsb3 = "/spi@16930000";
		gpsb4 = "/spi@16940000";
		gpsb5 = "/spi@16950000";
		tcc-overlay-drv1 = "/tcc_overlay_drv@1";
		vout-drv0 = "/vout_drv@0";
		fb0 = "/fb@0";
		fb1 = "/fb@1";
		fb2 = "/fb@2";
		fb3 = "/fb@3";
		mipi-csi2-0 = "/mipi_wrap/mipi_csi2_0@1bc00800";
		mipi-csi2-1 = "/mipi_wrap/mipi_csi2_1@1bc00c00";
		isp0 = "/mipi_wrap/isp0@1bc80000";
		isp1 = "/mipi_wrap/isp1@1bca0000";
		isp2 = "/mipi_wrap/isp2@1bcc0000";
		isp3 = "/mipi_wrap/isp3@1bce0000";
		videoinput0 = "/videoinput0";
		videoinput1 = "/videoinput1";
		videoinput2 = "/videoinput2";
		videoinput3 = "/videoinput3";
		videoinput4 = "/videoinput4";
		videoinput5 = "/videoinput5";
		videoinput6 = "/videoinput6";
		videoinput7 = "/videoinput7";
		camipc0 = "/camipc0";
		camipc1 = "/camipc1";
	};

	memory@40000000 {
		device_type = "memory";
		reg = < 0x00 0x40000000 0x00 0x40000000 >;
	};

	psci {
		compatible = "arm,psci-1.0";
		method = "smc";
	};

	reserved-memory {
		#address-cells = < 0x02 >;
		#size-cells = < 0x02 >;
		ranges;

		optee_os {
			compatible = "optee.os";
			reg = < 0x00 0x4e000000 0x00 0x2000000 >;
			no-map;
			status = "disabled";
		};

		fb_video {
			compatible = "telechips,pmap";
			telechips,pmap-name = "fb_video";
			status = "okay";
			reg = < 0x00 0x4a800000 0x00 0x1000000 >;
			alignment = < 0x1000 >;
			no-map;
			phandle = < 0x6f >;
		};

		fb1_video {
			compatible = "telechips,pmap";
			telechips,pmap-name = "fb1_video";
			status = "disabled";
			size = < 0x00 0x00 >;
			no-map;
		};

		fb2_video {
			compatible = "telechips,pmap";
			telechips,pmap-name = "fb2_video";
			status = "disabled";
			size = < 0x00 0x00 >;
			no-map;
		};

		fb3_video {
			compatible = "telechips,pmap";
			telechips,pmap-name = "fb3_video";
			status = "disabled";
			size = < 0x00 0x00 >;
			no-map;
		};

		fb_wmixer {
			alloc-ranges = < 0x00 0x20000000 0x00 0xa0000000 >;
			status = "disabled";
		};

		overlay {
			alloc-ranges = < 0x00 0x20000000 0x00 0xa0000000 >;
			status = "disabled";
		};

		overlay1 {
			alloc-ranges = < 0x00 0x20000000 0x00 0xa0000000 >;
			status = "disabled";
		};

		overlay_rot {
			alloc-ranges = < 0x00 0x20000000 0x00 0xa0000000 >;
			status = "okay";
			compatible = "telechips,pmap";
			telechips,pmap-name = "overlay_rot";
			size = < 0x00 0x00 >;
			no-map;
		};

		v4l2_vout0 {
			alloc-ranges = < 0x00 0x20000000 0x00 0xa0000000 >;
			status = "okay";
			compatible = "telechips,pmap";
			telechips,pmap-name = "v4l2_vout0";
			size = < 0x00 0x800000 >;
			no-map;
		};

		v4l2_vout1 {
			alloc-ranges = < 0x00 0x20000000 0x00 0xa0000000 >;
			status = "disabled";
		};

		viqe0 {
			alloc-ranges = < 0x00 0x20000000 0x00 0xa0000000 >;
			status = "okay";
			compatible = "telechips,pmap";
			telechips,pmap-name = "viqe";
			size = < 0x00 0x1000000 >;
			no-map;
		};

		viqe1 {
			alloc-ranges = < 0x00 0x20000000 0x00 0xa0000000 >;
			status = "disabled";
		};

		video_dual {
			alloc-ranges = < 0x00 0x20000000 0x00 0xa0000000 >;
			status = "disabled";
		};

		dual_display {
			alloc-ranges = < 0x00 0x20000000 0x00 0xa0000000 >;
			status = "disabled";
		};

		osd {
			alloc-ranges = < 0x00 0x20000000 0x00 0xa0000000 >;
			status = "disabled";
		};

		vpu_share_m {
			compatible = "telechips,map";
			reg = < 0x00 0x30000000 0x00 0x1000 >;
			no-map;
			status = "disabled";
		};

		vpu_share_s {
			compatible = "telechips,map";
			reg = < 0x00 0x50000000 0x00 0x1000 >;
			no-map;
			status = "okay";
		};

		video {
			compatible = "telechips,pmap";
			telechips,pmap-name = "video";
			alloc-ranges = < 0x00 0x20000000 0x00 0xa0000000 >;
			size = < 0x00 0x00 >;
			status = "disabled";
		};

		video_ext {
			compatible = "telechips,pmap";
			telechips,pmap-name = "video_ext";
			alloc-ranges = < 0x00 0x20000000 0x00 0xa0000000 >;
			size = < 0x00 0x00 >;
			status = "disabled";
		};

		video_ext2 {
			compatible = "telechips,pmap";
			telechips,pmap-name = "video_ext2";
			alloc-ranges = < 0x00 0x20000000 0x00 0xa0000000 >;
			size = < 0x00 0x00 >;
			status = "disabled";
		};

		video_sw {
			compatible = "telechips,pmap";
			telechips,pmap-name = "video_sw";
			alloc-ranges = < 0x00 0x20000000 0x00 0xa0000000 >;
			size = < 0x00 0x00 >;
			status = "disabled";
		};

		enc_main {
			compatible = "telechips,pmap";
			telechips,pmap-name = "enc_main";
			alloc-ranges = < 0x00 0x20000000 0x00 0xa0000000 >;
			size = < 0x00 0x00 >;
			status = "disabled";
		};

		enc_ext {
			compatible = "telechips,pmap";
			telechips,pmap-name = "enc_ext";
			alloc-ranges = < 0x00 0x20000000 0x00 0xa0000000 >;
			size = < 0x00 0x00 >;
			status = "disabled";
		};

		enc_ext2 {
			compatible = "telechips,pmap";
			telechips,pmap-name = "enc_ext2";
			alloc-ranges = < 0x00 0x20000000 0x00 0xa0000000 >;
			size = < 0x00 0x00 >;
			status = "disabled";
		};

		enc_ext3 {
			compatible = "telechips,pmap";
			telechips,pmap-name = "enc_ext3";
			alloc-ranges = < 0x00 0x20000000 0x00 0xa0000000 >;
			size = < 0x00 0x00 >;
			status = "disabled";
		};

		enc_ext4 {
			compatible = "telechips,pmap";
			telechips,pmap-name = "enc_ext4";
			alloc-ranges = < 0x00 0x20000000 0x00 0xa0000000 >;
			size = < 0x00 0x00 >;
			status = "disabled";
		};

		enc_ext5 {
			compatible = "telechips,pmap";
			telechips,pmap-name = "enc_ext5";
			alloc-ranges = < 0x00 0x20000000 0x00 0xa0000000 >;
			size = < 0x00 0x00 >;
			status = "disabled";
		};

		enc_ext6 {
			compatible = "telechips,pmap";
			telechips,pmap-name = "enc_ext6";
			alloc-ranges = < 0x00 0x20000000 0x00 0xa0000000 >;
			size = < 0x00 0x00 >;
			status = "disabled";
		};

		enc_ext7 {
			compatible = "telechips,pmap";
			telechips,pmap-name = "enc_ext7";
			alloc-ranges = < 0x00 0x20000000 0x00 0xa0000000 >;
			size = < 0x00 0x00 >;
			status = "disabled";
		};

		enc_ext8 {
			compatible = "telechips,pmap";
			telechips,pmap-name = "enc_ext8";
			alloc-ranges = < 0x00 0x20000000 0x00 0xa0000000 >;
			size = < 0x00 0x00 >;
			status = "disabled";
		};

		enc_ext9 {
			compatible = "telechips,pmap";
			telechips,pmap-name = "enc_ext9";
			alloc-ranges = < 0x00 0x20000000 0x00 0xa0000000 >;
			size = < 0x00 0x00 >;
			status = "disabled";
		};

		enc_ext10 {
			compatible = "telechips,pmap";
			telechips,pmap-name = "enc_ext10";
			alloc-ranges = < 0x00 0x20000000 0x00 0xa0000000 >;
			size = < 0x00 0x00 >;
			status = "disabled";
		};

		enc_ext11 {
			compatible = "telechips,pmap";
			telechips,pmap-name = "enc_ext11";
			alloc-ranges = < 0x00 0x20000000 0x00 0xa0000000 >;
			size = < 0x00 0x00 >;
			status = "disabled";
		};

		enc_ext12 {
			compatible = "telechips,pmap";
			telechips,pmap-name = "enc_ext12";
			alloc-ranges = < 0x00 0x20000000 0x00 0xa0000000 >;
			size = < 0x00 0x00 >;
			status = "disabled";
		};

		enc_ext13 {
			compatible = "telechips,pmap";
			telechips,pmap-name = "enc_ext13";
			alloc-ranges = < 0x00 0x20000000 0x00 0xa0000000 >;
			size = < 0x00 0x00 >;
			status = "disabled";
		};

		enc_ext14 {
			compatible = "telechips,pmap";
			telechips,pmap-name = "enc_ext14";
			alloc-ranges = < 0x00 0x20000000 0x00 0xa0000000 >;
			size = < 0x00 0x00 >;
			status = "disabled";
		};

		enc_ext15 {
			compatible = "telechips,pmap";
			telechips,pmap-name = "enc_ext15";
			alloc-ranges = < 0x00 0x20000000 0x00 0xa0000000 >;
			size = < 0x00 0x00 >;
			status = "disabled";
		};

		pmap_cam_viqe {
			compatible = "shared-dma-pool";
			alloc-ranges = < 0x00 0x20000000 0x00 0xa0000000 >;
			size = < 0x00 0x400000 >;
			alignment = < 0x00 0x1000 >;
			reusable;
			phandle = < 0x7f >;
		};

		pmap_cam0 {
			compatible = "shared-dma-pool";
			alloc-ranges = < 0x00 0x20000000 0x00 0xa0000000 >;
			size = < 0x00 0x2000000 >;
			alignment = < 0x00 0x1000 >;
			reusable;
			phandle = < 0x80 >;
		};

		pmap_cam1 {
			compatible = "shared-dma-pool";
			alloc-ranges = < 0x00 0x20000000 0x00 0xa0000000 >;
			size = < 0x00 0x00 >;
			alignment = < 0x00 0x1000 >;
			reusable;
		};

		pmap_cam2 {
			compatible = "shared-dma-pool";
			alloc-ranges = < 0x00 0x20000000 0x00 0xa0000000 >;
			size = < 0x00 0x00 >;
			alignment = < 0x00 0x1000 >;
			reusable;
		};

		pmap_cam3 {
			compatible = "shared-dma-pool";
			alloc-ranges = < 0x00 0x20000000 0x00 0xa0000000 >;
			size = < 0x00 0x00 >;
			alignment = < 0x00 0x1000 >;
			reusable;
		};

		pmap_cam4 {
			compatible = "shared-dma-pool";
			alloc-ranges = < 0x00 0x20000000 0x00 0xa0000000 >;
			size = < 0x00 0x2000000 >;
			alignment = < 0x00 0x1000 >;
			reusable;
			phandle = < 0x82 >;
		};

		pmap_cam5 {
			compatible = "shared-dma-pool";
			alloc-ranges = < 0x00 0x20000000 0x00 0xa0000000 >;
			size = < 0x00 0x2000000 >;
			alignment = < 0x00 0x1000 >;
			reusable;
			phandle = < 0x84 >;
		};

		pmap_cam6 {
			compatible = "shared-dma-pool";
			alloc-ranges = < 0x00 0x20000000 0x00 0xa0000000 >;
			size = < 0x00 0x2000000 >;
			alignment = < 0x00 0x1000 >;
			reusable;
			phandle = < 0x86 >;
		};

		pmap_cam7 {
			compatible = "shared-dma-pool";
			alloc-ranges = < 0x00 0x20000000 0x00 0xa0000000 >;
			size = < 0x00 0x2000000 >;
			alignment = < 0x00 0x1000 >;
			reusable;
			phandle = < 0x88 >;
		};
	};

	cpus {
		#address-cells = < 0x01 >;
		#size-cells = < 0x00 >;

		cpu@0 {
			device_type = "cpu";
			compatible = "arm,cortex-a53";
			reg = < 0x00 >;
			enable-method = "psci";
			next-level-cache = < 0x02 >;
			#cooling-cells = < 0x02 >;
			operating-points-v2 = < 0x03 >;
			clocks = < 0x04 0x17210000 >;
			phandle = < 0x05 >;
		};

		cpu@1 {
			device_type = "cpu";
			compatible = "arm,cortex-a53";
			reg = < 0x01 >;
			enable-method = "psci";
			next-level-cache = < 0x02 >;
			#cooling-cells = < 0x02 >;
			operating-points-v2 = < 0x03 >;
			phandle = < 0x06 >;
		};

		cpu@2 {
			device_type = "cpu";
			compatible = "arm,cortex-a53";
			reg = < 0x02 >;
			enable-method = "psci";
			next-level-cache = < 0x02 >;
			#cooling-cells = < 0x02 >;
			operating-points-v2 = < 0x03 >;
			phandle = < 0x07 >;
		};

		cpu@3 {
			device_type = "cpu";
			compatible = "arm,cortex-a53";
			reg = < 0x03 >;
			enable-method = "psci";
			next-level-cache = < 0x02 >;
			#cooling-cells = < 0x02 >;
			operating-points-v2 = < 0x03 >;
			phandle = < 0x08 >;
		};

		l2-cache {
			compatible = "cache";
			cache-level = < 0x02 >;
			phandle = < 0x02 >;
		};

		cpu_opp_table {
			compatible = "operating-points-v2";
			opp-shared;
			phandle = < 0x03 >;

			opp0 {
				opp-hz = < 0x00 0x566d3e80 >;
				opp-microvolt = < 0xdbba0 >;
				clock-latency-ns = < 0x493e0 >;
			};

			opp1 {
				opp-hz = < 0x00 0x53724e00 >;
				opp-microvolt = < 0xdbba0 >;
				clock-latency-ns = < 0x493e0 >;
			};

			opp2 {
				opp-hz = < 0x00 0x4190ab00 >;
				opp-microvolt = < 0xc3500 >;
				clock-latency-ns = < 0x493e0 >;
			};

			opp3 {
				opp-hz = < 0x00 0x3b9aca00 >;
				opp-microvolt = < 0xc3500 >;
				clock-latency-ns = < 0x493e0 >;
			};
		};
	};

	interrupt-controller@17C01000 {
		compatible = "arm,gic-400";
		#interrupt-cells = < 0x03 >;
		#address-cells = < 0x00 >;
		interrupt-controller;
		reg = < 0x00 0x17c01000 0x00 0x1000 0x00 0x17c02000 0x00 0x2000 0x00 0x17c04000 0x00 0x2000 0x00 0x17c06000 0x00 0x2000 >;
		phandle = < 0x01 >;
	};

	timer {
		compatible = "arm,armv8-timer";
		interrupts = < 0x01 0x0d 0xf08 0x01 0x0e 0xf08 0x01 0x0b 0xf08 0x01 0x0a 0xf08 >;
		arm,no-tick-in-suspend;
	};

	arm_pmu {
		compatible = "arm,cortex-a53-pmu";
		interrupts = < 0x00 0xb2 0x04 0x00 0xc0 0x04 0x00 0xc1 0x04 0x00 0xc2 0x04 >;
		interrupt-affinity = < 0x05 0x06 0x07 0x08 >;
	};

	osc24m {
		compatible = "fixed-clock";
		#clock-cells = < 0x02 >;
		clock-frequency = < 0x16e3600 >;
		clock-output-names = "osc24m";
		phandle = < 0x09 >;
	};

	osc32k {
		compatible = "fixed-clock";
		#clock-cells = < 0x02 >;
		clock-frequency = < 0x8000 >;
		clock-output-names = "osc32k";
		phandle = < 0x0c >;
	};

	extclk0 {
		compatible = "fixed-clock";
		#clock-cells = < 0x02 >;
		clock-frequency = < 0x00 >;
		clock-output-names = "extclk0";
		phandle = < 0x0d >;
	};

	extclk1 {
		compatible = "fixed-clock";
		#clock-cells = < 0x02 >;
		clock-frequency = < 0x00 >;
		clock-output-names = "extclk1";
		phandle = < 0x0e >;
	};

	smu_dpll_3200 {
		compatible = "telechips,clk-pll";
		type-fixed;
		#clock-cells = < 0x02 >;
		clocks = < 0x09 0x00 0x00 >;
		clock-indices = < 0x14000090 0x1400008c 0x14000088 >;
		clock-output-names = "pll4\0pll3\0pll2";
		ccf-flags = < 0x08 0x08 0x08 >;
		tc-flags = < 0x00 0x00 0x00 >;
		phandle = < 0x0b >;
	};

	smu_npll_3200 {
		compatible = "telechips,clk-pll";
		type-fixed;
		#clock-cells = < 0x02 >;
		clocks = < 0x09 0x00 0x00 >;
		clock-indices = < 0x14000084 0x14000080 >;
		clock-output-names = "pll1\0pll0";
		ccf-flags = < 0x08 0x08 >;
		tc-flags = < 0x00 0x00 >;
		phandle = < 0x0a >;
	};

	fbus_smu {
		compatible = "telechips,clk-fbus";
		type-fixed;
		#clock-cells = < 0x01 >;
		clocks = < 0x0a 0x14000080 0x00 0x0a 0x14000084 0x01 0x0b 0x14000088 0x02 0x0b 0x1400008c 0x03 0x0b 0x14000090 0x04 0x09 0x140ff000 0x05 0x09 0x00 0x05 0x0a 0x14000080 0x07 0x0a 0x14000084 0x08 0x0b 0x14000088 0x09 0x0b 0x1400008c 0x0a 0x0b 0x14000090 0x0b 0x09 0x140ff000 0x0c 0x09 0x00 0x05 0x09 0x00 0x05 0x09 0x00 0x05 >;
		clock-indices = < 0x14000008 0x1400000c 0x14000018 0x1400001c 0x14000024 0x1400002c 0x14000040 >;
		clock-output-names = "fbus_cbus\0fbus_cmbus\0fbus_hsio\0fbus_smu\0fbus_ddi\0fbus_io\0fbus_hsm";
		ccf-flags = < 0x09 0x08 0x09 0x09 0x09 0x801 0x09 >;
		tc-flags = < 0x00 0x00 0x00 0x00 0x00 0x00 0x00 >;
		phandle = < 0x10 >;
	};

	fbus_pcie {
		compatible = "telechips,clk-fbus";
		#clock-cells = < 0x01 >;
		clocks = < 0x0a 0x14000080 0x00 0x0a 0x14000084 0x01 0x0b 0x14000088 0x02 0x0b 0x1400008c 0x03 0x0b 0x14000090 0x04 0x09 0x140ff000 0x05 0x09 0x00 0x05 0x0a 0x14000080 0x07 0x0a 0x14000084 0x08 0x0b 0x14000088 0x09 0x0b 0x1400008c 0x0a 0x0b 0x14000090 0x0b 0x09 0x140ff000 0x0c 0x09 0x00 0x05 0x09 0x00 0x05 0x09 0x00 0x05 >;
		clock-indices = < 0x14000044 >;
		clock-output-names = "fbus_pcie0";
		ccf-flags = < 0x09 >;
		tc-flags = < 0x00 >;
	};

	clk_peri {
		compatible = "telechips,clk-peri";
		#clock-cells = < 0x01 >;
		clocks = < 0x0a 0x14000080 0x00 0x0a 0x14000084 0x01 0x0b 0x14000088 0x02 0x0b 0x1400008c 0x03 0x0b 0x14000090 0x04 0x09 0x140ff000 0x05 0x0c 0x140ff001 0x05 0x09 0x00 0x05 0x09 0x00 0x05 0x09 0x00 0x05 0x0a 0x14000080 0x0a 0x0a 0x14000084 0x0b 0x0b 0x14000088 0x0c 0x0b 0x1400008c 0x0d 0x0b 0x14000090 0x0e 0x09 0x00 0x05 0x09 0x00 0x05 0x09 0x00 0x05 0x09 0x00 0x05 0x09 0x00 0x05 0x09 0x00 0x05 0x09 0x00 0x05 0x09 0x00 0x05 0x09 0x140ff000 0x17 0x0c 0x140ff001 0x05 0x0d 0x00 0x19 0x0e 0x00 0x1a >;
		clock-indices = < 0x14000404 0x14000408 0x14000500 0x14000504 0x14000508 0x1400050c 0x14000518 0x14000600 0x14000604 0x14000610 0x14000700 0x14000704 0x14000708 0x1400070c 0x14000714 0x14000718 0x1400071c 0x14000720 0x14000724 0x14000728 0x1400072c 0x14000734 0x14000738 0x1400073c 0x14000740 0x14000744 0x14000748 0x1400074c 0x14000750 0x14000754 0x14000758 0x1400075c 0x14000760 0x14000764 0x14000768 0x1400076c 0x14000770 0x14000774 0x14000778 0x1400077c 0x14000780 0x14000784 0x14000788 0x14000790 0x14000794 0x14000798 0x1400079c 0x140007a0 0x140007a4 0x140007a8 0x140007ac 0x140007b0 0x140007b4 0x140007b8 0x140007bc 0x140007c0 0x140007c4 0x140007c8 0x140007cc 0x140007d0 0x140007d4 0x140007d8 0x140007dc 0x140007e0 0x14000800 0x14000804 0x14000808 0x1400080c 0x14000810 0x14000814 0x14000818 0x1400081c 0x14000820 0x14000900 0x14000a00 0x14000a04 0x14000a08 0x14000a0c 0x14000a10 0x14000a14 0x14000b00 >;
		clock-output-names = "peri_tct\0peri_tcz\0peri_lcdtimer\0peri_lcd0\0peri_lcd1\0peri_lcd2\0peri_lcd3\0peri_gmac\0peri_gmac_ptp\0peri_pcie0_phy_cr_clk\0peri_rmt\0peri_gpsb3\0peri_sdmmc1\0peri_sdmmc2\0peri_mdai0\0peri_mflt0_dai\0peri_mspdif0\0peri_srch0_core\0peri_srch0_filter\0peri_srch0_spdif\0peri_pdm\0peri_tsadc\0peri_i2c0\0peri_i2c1\0peri_i2c2\0peri_i2c3\0peri_uart0\0peri_uart1\0peri_uart2\0peri_uart3\0peri_mdai1\0peri_mflt1_dai\0peri_mspdif1\0peri_mdai2\0peri_gpsb0\0peri_gpsb1\0peri_gpsb2\0peri_gpsbms0\0peri_gpsbms1\0peri_gpsbms2\0peri_uart4\0peri_aux0_input\0peri_aux1_input\0peri_mflt2_dai\0peri_aux0_output\0peri_aux1_output\0peri_mspdif2\0peri_ic_tc\0peri_srch1_core\0peri_srch1_filter\0peri_srch1_spdif\0peri_srch2_core\0peri_srch2_filter\0peri_srch2_spdif\0peri_srch3_core\0peri_srch3_filter\0peri_srch3_spdif\0peri_uart5\0peri_uart6\0peri_uart7\0peri_uart8\0peri_mdai3\0peri_mflt3_dai\0peri_mspdif3\0peri_tsrx0\0peri_tsrx1\0peri_tsrx2\0peri_tsrx3\0peri_tsrx4\0peri_tsrx5\0peri_tsrx6\0peri_tsrx7\0peri_tsrx8\0peri_cb_wdt\0peri_out0\0peri_out1\0peri_out2\0peri_out3\0peri_out4\0peri_out5\0peri_hsmb";
		ccf-flags = < 0x08 0x08 0x08 0x08 0x08 0x08 0x08 0x08 0x08 0x08 0x08 0x08 0x08 0x08 0x08 0x08 0x08 0x08 0x08 0x08 0x08 0x08 0x08 0x08 0x08 0x08 0x08 0x08 0x08 0x08 0x08 0x08 0x08 0x08 0x08 0x08 0x08 0x08 0x08 0x08 0x08 0x08 0x08 0x08 0x08 0x08 0x08 0x08 0x08 0x08 0x08 0x08 0x08 0x08 0x08 0x08 0x08 0x08 0x08 0x08 0x08 0x08 0x08 0x08 0x08 0x08 0x08 0x08 0x08 0x08 0x08 0x08 0x08 0x08 0x08 0x08 0x08 0x08 0x08 0x08 0x08 >;
		tc-flags = < 0x00 0x00 0x00 0x00 0x00 0x00 0x00 0x00 0x00 0x00 0x00 0x00 0x00 0x00 0x00 0x00 0x00 0x00 0x00 0x00 0x00 0x00 0x00 0x00 0x00 0x00 0x00 0x00 0x00 0x00 0x00 0x00 0x00 0x00 0x00 0x00 0x00 0x00 0x00 0x00 0x00 0x00 0x00 0x00 0x00 0x00 0x00 0x00 0x00 0x00 0x00 0x00 0x00 0x00 0x00 0x00 0x00 0x00 0x00 0x00 0x00 0x00 0x00 0x00 0x00 0x00 0x00 0x00 0x00 0x00 0x00 0x00 0x00 0x00 0x00 0x00 0x00 0x00 0x00 0x00 0x00 >;
		phandle = < 0x1e >;
	};

	subsys_npll_3200 {
		compatible = "telechips,clk-pll";
		type-fixed;
		#clock-cells = < 0x02 >;
		clocks = < 0x09 0x00 0x00 >;
		clock-indices = < 0x15280020 0x15280010 0x13540010 0x1a000008 0x10000008 0x17210008 0x17110008 >;
		clock-output-names = "pll_video_1\0pll_video_0\0pll_mem\0pll_g2d\0pll_gpu\0pll_ca53\0pll_ca72";
		ccf-flags = < 0x808 0x808 0x808 0x808 0x808 0x808 >;
		tc-flags = < 0x00 0x00 0x00 0x00 0x00 0x00 >;
		phandle = < 0x0f >;
	};

	mem_phy_pll_4300 {
		compatible = "telechips,clk-pll";
		type-fixed;
		#clock-cells = < 0x02 >;
		clocks = < 0x09 0x00 0x00 >;
		clock-indices = < 0x13450000 0x13440000 0x13350000 0x13340000 >;
		clock-output-names = "pll_mem_phy_3\0pll_mem_phy_2\0pll_mem_phy_1\0pll_mem_phy_0";
		ccf-flags = < 0x08 0x08 0x08 0x08 >;
		tc-flags = < 0x00 0x00 0x00 0x00 >;
	};

	cpu_ca72 {
		compatible = "telechips,clk-fbus";
		#clock-cells = < 0x01 >;
		clocks = < 0x09 0x140ff000 0x00 0x0f 0x17110008 0x01 0x0f 0x17110008 0x02 >;
		clock-indices = < 0x17110000 >;
		clock-output-names = "ca72";
		ccf-flags = < 0x800 >;
		tc-flags = < 0x00 >;
	};

	cpu_ca53 {
		compatible = "telechips,clk-fbus";
		#clock-cells = < 0x01 >;
		clocks = < 0x09 0x140ff000 0x00 0x0f 0x17210008 0x01 0x0f 0x17210008 0x02 >;
		clock-indices = < 0x17210000 >;
		clock-output-names = "ca53";
		ccf-flags = < 0x800 >;
		tc-flags = < 0x00 >;
		phandle = < 0x04 >;
	};

	fbus_mem {
		compatible = "telechips,clk-fbus";
		#clock-cells = < 0x01 >;
		clocks = < 0x09 0x140ff000 0x00 0x0f 0x13540010 0x01 0x0f 0x13540010 0x01 0x0f 0x13540010 0x03 0x0f 0x13540010 0x04 0x0f 0x13540010 0x05 0x0f 0x13540010 0x06 0x0c 0x140ff001 0x07 >;
		clock-indices = < 0x13540000 0x13540004 0x13540008 0x1354000c >;
		clock-output-names = "fbus_mem\0fbus_mem_sub\0fbus_mem_phy_user\0fbus_mem_phy_peri";
		ccf-flags = < 0x808 0x808 0x808 0x808 >;
		tc-flags = < 0x00 0x00 0x00 0x00 >;
	};

	fbus_gpu {
		compatible = "telechips,clk-fbus";
		#clock-cells = < 0x01 >;
		clocks = < 0x09 0x140ff000 0x00 0x0f 0x10000008 0x01 0x0f 0x10000008 0x02 >;
		clock-indices = < 0x10000000 >;
		clock-output-names = "fbus_gpu";
		ccf-flags = < 0x09 >;
		tc-flags = < 0x00 >;
		phandle = < 0x74 >;
	};

	fbus_g2d {
		compatible = "telechips,clk-fbus";
		#clock-cells = < 0x01 >;
		clocks = < 0x09 0x140ff000 0x00 0x0f 0x1a000008 0x01 0x0f 0x1a000008 0x02 >;
		clock-indices = < 0x1a000000 >;
		clock-output-names = "fbus_g2d";
		ccf-flags = < 0x09 >;
		tc-flags = < 0x00 >;
	};

	gate_io {
		compatible = "telechips,clk-gate";
		#clock-cells = < 0x01 >;
		clocks = < 0x10 0x1400002c >;
		clock-indices = < 0x40 0x45 0x46 0x47 0x48 0x49 0x4a 0x4c 0x4e 0x50 0x54 0x55 0x56 0x57 0x58 0x59 0x5a 0x5b 0x5c 0x5d 0x5e 0x5f 0x60 0x61 0x62 0x63 0x64 0x71 0x73 0x74 0x75 0x76 0x77 0x78 0x79 0x7b 0x7c 0x7d 0x7e 0x7f 0x80 0x81 0x82 0x83 0x84 0x85 0x86 0x87 0x88 0x90 0x91 0x92 0x93 0x96 0x97 0x98 0x99 0x9a 0xc0 0xc1 0xc2 0xc3 0xc4 0xc5 0xc6 0xc7 0xc8 0xc9 0xca 0xcb 0xcc 0xcd 0xce 0xcf 0xd0 0xd1 0xd2 0xd3 0xd4 0xd5 0xd7 0xa0 0xa3 0xa4 0xa5 0xaa >;
		clock-output-names = "iobus_ic_tc\0iobus_pl080\0iobus_asrc\0iobus_dma0\0iobus_dma1\0iobus_dma2\0iobus_dma\0iobus_pwm\0iobus_i2c_s2\0iobus_remocon\0iobus_prt\0iobus_adma0\0iobus_dai0\0iobus_spdif0\0iobus_audio0\0iobus_adma3\0iobus_dai3\0iobus_spdif3\0iobus_audio3\0iobus_i2c_m0\0iobus_i2c_m1\0iobus_i2c_m2\0iobus_i2c_m3\0iobus_i2c_s0\0iobus_i2c_s1\0iobus_i2c0\0iobus_i2c1\0iobus_gpsb_2\0iobus_gpsb0\0iobus_gpsb1\0iobus_gpsb2\0iobus_gpsb3\0iobus_gpsb4\0iobus_gpsb5\0iobus_gpsb\0iobus_i2c_s3\0iobus_i2c_m4\0iobus_i2c_m5\0iobus_i2c_m6\0iobus_i2c_m7\0iobus_uart0\0iobus_uart1\0iobus_uart2\0iobus_uart3\0iobus_uart4\0iobus_uart5\0iobus_uart6\0iobus_uart7\0iobus_uart8\0iobus_udma0\0iobus_udma1\0iobus_udma2\0iobus_udma3\0iobus_udma4\0iobus_udma5\0iobus_udma6\0iobus_udma7\0iobus_udma8\0iobus_adma1\0iobus_dai1\0iobus_spdif1\0iobus_audio1\0iobus_adma2\0iobus_dai2\0iobus_spdif2\0iobus_audio2\0iobus_adma4\0iobus_dai4\0iobus_spdif4\0iobus_audio4\0iobus_adma5\0iobus_dai5\0iobus_spdif5\0iobus_audio5\0iobus_adma6\0iobus_dai6\0iobus_spdif6\0iobus_audio6\0iobus_adma7\0iobus_dai7\0iobus_audio7\0iobus_gdma1\0iobus_sdmmc1\0iobus_sdmmc2\0iobus_sdmmc\0iobus_rtc";
		ccf-flags = < 0x08 0x08 0x08 0x08 0x08 0x08 0x08 0x08 0x08 0x08 0x08 0x08 0x08 0x08 0x08 0x08 0x08 0x08 0x08 0x08 0x08 0x08 0x08 0x08 0x08 0x08 0x08 0x08 0x08 0x08 0x08 0x08 0x08 0x08 0x08 0x08 0x08 0x08 0x08 0x08 0x08 0x08 0x08 0x08 0x08 0x08 0x08 0x08 0x08 0x08 0x08 0x08 0x08 0x08 0x08 0x08 0x08 0x08 0x08 0x08 0x08 0x08 0x08 0x08 0x08 0x08 0x08 0x08 0x08 0x08 0x08 0x08 0x08 0x08 0x08 0x08 0x08 0x08 0x08 0x08 0x08 0x08 0x08 0x08 0x08 >;
		tc-flags = < 0x00 0x00 0x00 0x00 0x00 0x00 0x00 0x00 0x00 0x00 0x00 0x00 0x00 0x00 0x00 0x00 0x00 0x00 0x00 0x00 0x00 0x00 0x00 0x00 0x00 0x00 0x00 0x00 0x00 0x00 0x00 0x00 0x00 0x00 0x00 0x00 0x00 0x00 0x00 0x00 0x00 0x00 0x00 0x00 0x00 0x00 0x00 0x00 0x00 0x00 0x00 0x00 0x00 0x00 0x00 0x00 0x00 0x00 0x00 0x00 0x00 0x00 0x00 0x00 0x00 0x00 0x00 0x00 0x00 0x00 0x00 0x00 0x00 0x00 0x00 0x00 0x00 0x00 0x00 0x00 0x00 0x00 0x00 0x00 0x00 >;
		phandle = < 0x15 >;
	};

	gate_hsio {
		compatible = "telechips,clk-gate";
		#clock-cells = < 0x01 >;
		clocks = < 0x10 0x14000018 >;
		clock-indices = < 0x100 0x102 0x106 0x112 0x113 0x115 0x116 >;
		clock-output-names = "hsiobus_usb30\0hsiobus_gmac\0hsiobus_usb20h\0hsiobus_cipher\0hsiobus_dwc_otg\0hsiobus_secure_wrap\0hsiobus_trng";
		ccf-flags = < 0x08 0x08 0x08 0x08 0x08 0x08 0x08 >;
		tc-flags = < 0x00 0x00 0x00 0x00 0x00 0x00 0x00 >;
	};

	gate_ddi {
		compatible = "telechips,clk-gate";
		#clock-cells = < 0x01 >;
		clocks = < 0x10 0x14000024 >;
		clock-indices = < 0x120 0x121 0x122 0x123 >;
		clock-output-names = "ddibus_vioc\0ddibus_hdmi\0ddibus_mipi\0ddibus_lvds";
		ccf-flags = < 0x808 0x08 0x08 0x08 >;
		tc-flags = < 0x00 0x00 0x00 0x00 >;
		phandle = < 0x47 >;
	};

	fbus_vpu {
		compatible = "telechips,clk-fbus";
		#clock-cells = < 0x01 >;
		clocks = < 0x09 0x140ff000 0x00 0x0f 0x15280010 0x01 0x0f 0x15280020 0x02 0x0f 0x15280010 0x03 0x0f 0x15280010 0x04 0x0f 0x15280020 0x05 0x0f 0x15280020 0x06 >;
		clock-indices = < 0x15280000 0x15280004 0x15280008 0x1528000c 0x15280034 0x15280038 >;
		clock-output-names = "fbus_vbus\0fbus_coda\0fbus_chevcdec\0fbus_bhevcdec\0fbus_chevcenc\0fbus_bhevcenc";
		ccf-flags = < 0x09 0x09 0x09 0x09 0x09 0x09 >;
		tc-flags = < 0x00 0x00 0x00 0x00 0x00 0x00 >;
		phandle = < 0x11 >;
	};

	gate_vpu {
		compatible = "telechips,clk-gate";
		#clock-cells = < 0x01 >;
		clocks = < 0x11 0x15280000 >;
		clock-indices = < 0x140 0x141 0x142 0x143 0x144 0x145 >;
		clock-output-names = "videobus_jpeg\0videobus_coda_bus\0videobus_coda_core\0videobus_hevc_bus\0videobus_hevc_core\0videobus_hevc_encoder";
		ccf-flags = < 0x08 0x08 0x08 0x08 0x08 0x08 >;
		tc-flags = < 0x00 0x00 0x00 0x00 0x00 0x00 >;
		phandle = < 0x72 >;
	};

	reboot-mode {
		compatible = "telechips,reboot-mode";
		mode-normal = < 0x51 >;
		mode-bootloader = < 0x50 >;
		mode-recovery = < 0x52 >;
		mode-ddrcheck = < 0x54 >;
		mode-secureboot = < 0x56 >;
		record-panic = < 0x02 >;
	};

	reset-controller@140000b4 {
		compatible = "telechips,reset";
		#reset-cells = < 0x01 >;
		reset-range = < 0x00 0x1f >;
	};

	reset-controller@15100004 {
		compatible = "telechips,vpubus-reset";
		#reset-cells = < 0x01 >;
		reset-range = < 0x140 0x15f >;
		phandle = < 0x73 >;
	};

	reset-controller@12380004 {
		compatible = "telechips,ddibus-reset";
		#reset-cells = < 0x01 >;
		reset-range = < 0x120 0x13f >;
	};

	reset-controller@1605100c {
		compatible = "telechips,iobus-reset";
		#reset-cells = < 0x01 >;
		reset-range = < 0x40 0xff >;
		phandle = < 0x21 >;
	};

	reset-controller@111a0004 {
		compatible = "telechips,hsiobus-reset";
		#reset-cells = < 0x01 >;
		reset-range = < 0x100 0x11f >;
	};

	mbox@1D210000 {
		compatible = "telechips,mailbox-controller-v2";
		reg = < 0x00 0x1d210000 0x00 0x80 >;
		interrupts = < 0x00 0x140 0x04 0x00 0x14a 0x04 >;
		#mbox-cells = < 0x01 >;
		phandle = < 0x12 >;
	};

	mbox@17B00000 {
		compatible = "telechips,mailbox-controller-v2";
		reg = < 0x00 0x17b00000 0x00 0x100 >;
		interrupts = < 0x00 0x16d 0x04 0x00 0x16e 0x04 >;
		#mbox-cells = < 0x01 >;
		phandle = < 0x3a >;
	};

	mbox@1BA30000 {
		compatible = "telechips,mailbox-controller-v2";
		reg = < 0x00 0x1ba30000 0x00 0x100 >;
		interrupts = < 0x00 0x1bc 0x04 0x00 0x1bd 0x04 >;
		#mbox-cells = < 0x01 >;
		phandle = < 0x3b >;
	};

	mbox@1E110000 {
		compatible = "telechips,mailbox-controller-v2";
		reg = < 0x00 0x1e110000 0x00 0x100 >;
		interrupts = < 0x00 0x134 0x04 0x00 0x150 0x04 >;
		#mbox-cells = < 0x01 >;
		phandle = < 0x3c >;
	};

	tcc_sc_fw {
		status = "okay";
		compatible = "telechips,tcc805x-sc-fw";
		mboxes = < 0x12 0x00 >;
		phandle = < 0x13 >;
	};

	pinctrl@14200000 {
		compatible = "telechips,tcc-pinctrl";
		reg = < 0x00 0x14200000 0x00 0x7c0 0x00 0x1b937000 0x00 0xa30 >;
		sc-firmware = < 0x13 >;
		phandle = < 0x14 >;

		pinctrl_gpio {

			gpa {
				pin-info = < 0x00 0x00 0x20 >;
				source-num = < 0x01 0x00 0x01 0x20 >;
			};

			gpb {
				pin-info = < 0x40 0x00 0x1d >;
				source-num = < 0x01 0x00 0x21 0x1d >;
			};

			gpc {
				pin-info = < 0x80 0x00 0x1e >;
				source-num = < 0x01 0x00 0x3e 0x1e >;
			};

			gpe {
				pin-info = < 0x100 0x00 0x14 >;
				source-num = < 0x01 0x00 0x5c 0x14 >;
			};

			gpg {
				pin-info = < 0x180 0x00 0x0b >;
				source-num = < 0x01 0x00 0x70 0x0b >;
			};

			gph {
				pin-info = < 0x640 0x00 0x0c >;
				source-num = < 0x01 0x00 0x7b 0x0c >;
			};

			gpk {
				pin-info = < 0x800 0x00 0x13 >;
				source-num = < 0xff >;
			};

			gpsd0 {
				pin-info = < 0x200 0x00 0x0f >;
				source-num = < 0x01 0x00 0xa5 0x0f >;
			};

			gpsd1 {
				pin-info = < 0x240 0x00 0x0b >;
				source-num = < 0x01 0x00 0xb4 0x0b >;
			};

			gpsd2 {
				pin-info = < 0x600 0x00 0x0a >;
				source-num = < 0x01 0x00 0xbf 0x0a >;
			};

			gpma {
				pin-info = < 0x6c0 0x00 0x1e >;
				source-num = < 0x01 0x00 0x87 0x1e >;
			};

			gpmb {
				pin-info = < 0x700 0x00 0x20 >;
				source-num = < 0x01 0x00 0xca 0x1e >;
			};

			gpmc {
				pin-info = < 0x740 0x00 0x1e >;
				source-num = < 0x01 0x00 0xe4 0x1e >;
			};

			gpmd {
				pin-info = < 0x780 0x00 0x12 >;
				source-num = < 0x02 0x08 0xfc 0x02 0x10 0xfe 0x02 >;
			};
		};

		lcd_port_default1 {
			telechips,pins = "gpa-21\0gpg-6\0gph-6";
			telechips,pin-function = < 0x00 >;
			telechips,no-pull;
		};

		lcd_port_power_on1 {
			telechips,pins = "gpa-21";
			telechips,pin-function = < 0x00 >;
			telechips,output-high;
		};

		lcd_port_power_off1 {
			telechips,pins = "gpa-21";
			telechips,pin-function = < 0x00 >;
			telechips,output-low;
		};

		lcd_port_reset_on1 {
			telechips,pins = "gpg-6";
			telechips,pin-function = < 0x00 >;
			telechips,output-low;
		};

		lcd_port_reset_off1 {
			telechips,pins = "gpg-6";
			telechips,pin-function = < 0x00 >;
			telechips,output-high;
		};

		lcd_port_blk_on1 {
			telechips,pins = "gph-6";
			telechips,pin-function = < 0x00 >;
			telechips,output-high;
		};

		lcd_port_blk_off1 {
			telechips,pins = "gph-6";
			telechips,pin-function = < 0x00 >;
			telechips,output-low;
		};

		lcd_port_default2 {
			telechips,pins = "gpmb-28\0gpc-12\0gph-7";
			telechips,pin-function = < 0x00 >;
			telechips,no-pull;
		};

		lcd_port_power_on2 {
			telechips,pins = "gpmb-28";
			telechips,pin-function = < 0x00 >;
			telechips,output-high;
		};

		lcd_port_power_off2 {
			telechips,pins = "gpmb-28";
			telechips,pin-function = < 0x00 >;
			telechips,output-low;
		};

		lcd_port_reset_on2 {
			telechips,pins = "gpc-12";
			telechips,pin-function = < 0x00 >;
			telechips,output-low;
		};

		lcd_port_reset_off2 {
			telechips,pins = "gpc-12";
			telechips,pin-function = < 0x00 >;
			telechips,output-high;
		};

		lcd_port_blk_on2 {
			telechips,pins = "gph-7";
			telechips,pin-function = < 0x00 >;
			telechips,output-high;
		};

		lcd_port_blk_off2 {
			telechips,pins = "gph-7";
			telechips,pin-function = < 0x00 >;
			telechips,output-low;
		};

		lcd_port_default3 {
			telechips,pins = "gpc-9\0gpc-8\0gpmb-29";
			telechips,pin-function = < 0x00 >;
			telechips,no-pull;
			phandle = < 0x5b >;
		};

		lcd_port_power_on3 {
			telechips,pins = "gpc-9";
			telechips,pin-function = < 0x00 >;
			telechips,output-high;
			phandle = < 0x5c >;
		};

		lcd_port_power_off3 {
			telechips,pins = "gpc-9";
			telechips,pin-function = < 0x00 >;
			telechips,output-low;
			phandle = < 0x61 >;
		};

		lcd_port_reset_on3 {
			telechips,pins = "gpc-8";
			telechips,pin-function = < 0x00 >;
			telechips,output-low;
			phandle = < 0x60 >;
		};

		lcd_port_reset_off3 {
			telechips,pins = "gpc-8";
			telechips,pin-function = < 0x00 >;
			telechips,output-high;
			phandle = < 0x5d >;
		};

		lcd_port_blk_on3 {
			telechips,pins = "gpmb-29";
			telechips,pin-function = < 0x00 >;
			telechips,output-high;
			phandle = < 0x5e >;
		};

		lcd_port_blk_off3 {
			telechips,pins = "gpmb-29";
			telechips,pin-function = < 0x00 >;
			telechips,output-low;
			phandle = < 0x5f >;
		};

		lcd_port_default4 {
			telechips,pins = "gpmc-23\0gpmc-25\0gpmc-21";
			telechips,pin-function = < 0x00 >;
			telechips,no-pull;
		};

		lcd_port_power_on4 {
			telechips,pins = "gpmc-23";
			telechips,pin-function = < 0x00 >;
			telechips,output-high;
		};

		lcd_port_power_off4 {
			telechips,pins = "gpmc-23";
			telechips,pin-function = < 0x00 >;
			telechips,output-low;
		};

		lcd_port_reset_on4 {
			telechips,pins = "gpmc-25";
			telechips,pin-function = < 0x00 >;
			telechips,output-low;
		};

		lcd_port_reset_off4 {
			telechips,pins = "gpmc-25";
			telechips,pin-function = < 0x00 >;
			telechips,output-high;
		};

		lcd_port_blk_on4 {
			telechips,pins = "gpmc-21";
			telechips,pin-function = < 0x00 >;
			telechips,output-high;
		};

		lcd_port_blk_off4 {
			telechips,pins = "gpmc-21";
			telechips,pin-function = < 0x00 >;
			telechips,output-low;
		};

		dp_hpd_gpio {
			telechips,pins = "gpc-14";
			telechips,pin-function = < 0x01 >;
			telechips,input-enable;
			telechips,pull-down;
		};

		serdes_intb {
			telechips,pins = "gpsd0-11";
			telechips,pin-function = < 0x00 >;
			telechips,input-enable;
			telechips,no-pull;
		};

		serdes_lock {
			telechips,pins = "gpmc-0";
			telechips,pin-function = < 0x00 >;
			telechips,input-enable;
			telechips,no-pull;
		};

		uart0_data {
			telechips,pins = "gpsd0-11\0gpsd0-12";
			telechips,pin-function = < 0x07 >;
			telechips,input_buffer_enable;
		};

		uart0_rtscts {
			telechips,pins = "gpsd0-13\0gpsd0-14";
			telechips,pin-function = < 0x07 >;
			telechips,input_buffer_enable;
		};

		uart1_data {
			telechips,pins = "gpsd1-0\0gpsd1-1";
			telechips,pin-function = < 0x07 >;
			telechips,input_buffer_enable;
		};

		uart1_rtscts {
			telechips,pins = "gpsd1-2\0gpsd1-3";
			telechips,pin-function = < 0x07 >;
			telechips,input_buffer_enable;
		};

		uart2_data {
			telechips,pins = "gpsd1-6\0gpsd1-7";
			telechips,pin-function = < 0x07 >;
			telechips,input_buffer_enable;
		};

		uart2_rtscts {
			telechips,pins = "gpsd1-8\0gpsd1-9";
			telechips,pin-function = < 0x07 >;
			telechips,input_buffer_enable;
		};

		uart3_data {
			telechips,pins = "gpsd2-0\0gpsd2-1";
			telechips,pin-function = < 0x07 >;
			telechips,input_buffer_enable;
		};

		uart3_rtscts {
			telechips,pins = "gpsd2-2\0gpsd2-3";
			telechips,pin-function = < 0x07 >;
			telechips,input_buffer_enable;
		};

		uart4_data {
			telechips,pins = "gpsd2-6\0gpsd2-7";
			telechips,pin-function = < 0x07 >;
			telechips,input_buffer_enable;
		};

		uart4_rtscts {
			telechips,pins = "gpsd2-8\0gpsd2-9";
			telechips,pin-function = < 0x07 >;
			telechips,input_buffer_enable;
		};

		uart5_data {
			telechips,pins = "gpa-0\0gpa-1";
			telechips,pin-function = < 0x07 >;
			telechips,input_buffer_enable;
		};

		uart5_rtscts {
			telechips,pins = "gpa-2\0gpa-3";
			telechips,pin-function = < 0x07 >;
			telechips,input_buffer_enable;
		};

		uart6_data {
			telechips,pins = "gpa-6\0gpa-7";
			telechips,pin-function = < 0x07 >;
			telechips,input_buffer_enable;
		};

		uart6_rtscts {
			telechips,pins = "gpa-8\0gpa-9";
			telechips,pin-function = < 0x07 >;
			telechips,input_buffer_enable;
		};

		uart7_data {
			telechips,pins = "gpa-12\0gpa-13";
			telechips,pin-function = < 0x07 >;
			telechips,input_buffer_enable;
		};

		uart7_rtscts {
			telechips,pins = "gpa-14\0gpa-15";
			telechips,pin-function = < 0x07 >;
			telechips,input_buffer_enable;
		};

		uart8_data {
			telechips,pins = "gpa-18\0gpa-19";
			telechips,pin-function = < 0x07 >;
			telechips,input_buffer_enable;
		};

		uart8_rtscts {
			telechips,pins = "gpa-20\0gpa-21";
			telechips,pin-function = < 0x07 >;
			telechips,input_buffer_enable;
		};

		uart9_data {
			telechips,pins = "gpa-24\0gpa-25";
			telechips,pin-function = < 0x07 >;
			telechips,input_buffer_enable;
			phandle = < 0x1f >;
		};

		uart9_rtscts {
			telechips,pins = "gpa-26\0gpa-27";
			telechips,pin-function = < 0x07 >;
			telechips,input_buffer_enable;
		};

		uart10_data {
			telechips,pins = "gpb-0\0gpb-1";
			telechips,pin-function = < 0x07 >;
			telechips,input_buffer_enable;
		};

		uart10_rtscts {
			telechips,pins = "gpb-2\0gpb-3";
			telechips,pin-function = < 0x07 >;
			telechips,input_buffer_enable;
		};

		uart11_data {
			telechips,pins = "gpb-6\0gpb-7";
			telechips,pin-function = < 0x07 >;
			telechips,input_buffer_enable;
		};

		uart11_rtscts {
			telechips,pins = "gpb-8\0gpb-9";
			telechips,pin-function = < 0x07 >;
			telechips,input_buffer_enable;
		};

		uart12_data {
			telechips,pins = "gpb-12\0gpb-13";
			telechips,pin-function = < 0x07 >;
			telechips,input_buffer_enable;
		};

		uart12_rtscts {
			telechips,pins = "gpb-14\0gpb-15";
			telechips,pin-function = < 0x07 >;
			telechips,input_buffer_enable;
		};

		uart13_data {
			telechips,pins = "gpb-19\0gpb-20";
			telechips,pin-function = < 0x07 >;
			telechips,input_buffer_enable;
		};

		uart13_rtscts {
			telechips,pins = "gpb-21\0gpb-22";
			telechips,pin-function = < 0x07 >;
			telechips,input_buffer_enable;
		};

		uart14_data {
			telechips,pins = "gpb-25\0gpb-26";
			telechips,pin-function = < 0x07 >;
			telechips,input_buffer_enable;
		};

		uart14_rtscts {
			telechips,pins = "gpb-27\0gpb-28";
			telechips,pin-function = < 0x07 >;
			telechips,input_buffer_enable;
		};

		uart15_data {
			telechips,pins = "gpc-0\0gpc-1";
			telechips,pin-function = < 0x07 >;
			telechips,input_buffer_enable;
		};

		uart15_rtscts {
			telechips,pins = "gpc-2\0gpc-3";
			telechips,pin-function = < 0x07 >;
			telechips,input_buffer_enable;
		};

		uart16_data {
			telechips,pins = "gpc-4\0gpc-5";
			telechips,pin-function = < 0x07 >;
			telechips,input_buffer_enable;
		};

		uart16_rtscts {
			telechips,pins = "gpc-6\0gpc-7";
			telechips,pin-function = < 0x07 >;
			telechips,input_buffer_enable;
		};

		uart17_data {
			telechips,pins = "gpc-8\0gpc-9";
			telechips,pin-function = < 0x07 >;
			telechips,input_buffer_enable;
		};

		uart17_rtscts {
			telechips,pins = "gpc-10\0gpc-11";
			telechips,pin-function = < 0x07 >;
			telechips,input_buffer_enable;
		};

		uart18_data {
			telechips,pins = "gpc-10\0gpc-11";
			telechips,pin-function = < 0x08 >;
			telechips,input_buffer_enable;
		};

		uart18_rtscts {
			telechips,pins = "gpc-12\0gpb-13";
			telechips,pin-function = < 0x08 >;
			telechips,input_buffer_enable;
		};

		uart19_data {
			telechips,pins = "gpc-12\0gpc-13";
			telechips,pin-function = < 0x07 >;
			telechips,input_buffer_enable;
		};

		uart19_rtscts {
			telechips,pins = "gpc-14\0gpc-15";
			telechips,pin-function = < 0x07 >;
			telechips,input_buffer_enable;
		};

		uart20_data {
			telechips,pins = "gpc-16\0gpc-17";
			telechips,pin-function = < 0x07 >;
			telechips,input_buffer_enable;
			telechips,pull-up;
		};

		uart20_rtscts {
			telechips,pins = "gpc-18\0gpc-19";
			telechips,pin-function = < 0x07 >;
			telechips,input_buffer_enable;
			telechips,pull-up;
		};

		uart21_data {
			telechips,pins = "gpc-20\0gpc-21";
			telechips,pin-function = < 0x07 >;
			telechips,input_buffer_enable;
		};

		uart21_rtscts {
			telechips,pins = "gpc-22\0gpc-23";
			telechips,pin-function = < 0x07 >;
			telechips,input_buffer_enable;
		};

		uart22_data {
			telechips,pins = "gpc-26\0gpc-27";
			telechips,pin-function = < 0x07 >;
			telechips,input_buffer_enable;
		};

		uart22_rtscts {
			telechips,pins = "gpc-28\0gpc-29";
			telechips,pin-function = < 0x07 >;
			telechips,input_buffer_enable;
		};

		uart23_data {
			telechips,pins = "gpg-0\0gpg-1";
			telechips,pin-function = < 0x07 >;
			telechips,input_buffer_enable;
		};

		uart23_rtscts {
			telechips,pins = "gpg-2\0gpg-3";
			telechips,pin-function = < 0x07 >;
			telechips,input_buffer_enable;
		};

		uart24_data {
			telechips,pins = "gpg-7\0gpg-8";
			telechips,pin-function = < 0x07 >;
			telechips,input_buffer_enable;
		};

		uart24_rtscts {
			telechips,pins = "gpg-9\0gpg-10";
			telechips,pin-function = < 0x07 >;
			telechips,input_buffer_enable;
		};

		uart25_data {
			telechips,pins = "gpe-5\0gpe-6";
			telechips,pin-function = < 0x07 >;
			telechips,input_buffer_enable;
		};

		uart25_rtscts {
			telechips,pins = "gpe-7\0gpe-8";
			telechips,pin-function = < 0x07 >;
			telechips,input_buffer_enable;
		};

		uart26_data {
			telechips,pins = "gpe-11\0gpe-12";
			telechips,pin-function = < 0x07 >;
			telechips,input_buffer_enable;
		};

		uart26_rtscts {
			telechips,pins = "gpe-13\0gpe-14";
			telechips,pin-function = < 0x07 >;
			telechips,input_buffer_enable;
		};

		uart27_data {
			telechips,pins = "gpe-16\0gpe-17";
			telechips,pin-function = < 0x07 >;
			telechips,input_buffer_enable;
		};

		uart27_rtscts {
			telechips,pins = "gpe-18\0gpe-19";
			telechips,pin-function = < 0x07 >;
			telechips,input_buffer_enable;
		};

		uart28_data {
			telechips,pins = "gph-4\0gph-5";
			telechips,pin-function = < 0x07 >;
			telechips,input_buffer_enable;
		};

		uart28_rtscts {
			telechips,pins = "gph-6\0gph-7";
			telechips,pin-function = < 0x07 >;
			telechips,input_buffer_enable;
		};

		uart29_data {
			telechips,pins = "gph-6\0gph-7";
			telechips,pin-function = < 0x08 >;
			telechips,input_buffer_enable;
		};

		uart29_rtscts {
			telechips,pins = "gph-8\0gph-9";
			telechips,pin-function = < 0x08 >;
			telechips,input_buffer_enable;
		};

		uart30_data {
			telechips,pins = "gph-0\0gph-1";
			telechips,pin-function = < 0x07 >;
			telechips,input_buffer_enable;
		};

		uart30_rtscts {
			telechips,pins = "gph-2\0gph-3";
			telechips,pin-function = < 0x07 >;
			telechips,input_buffer_enable;
		};

		uart31_data {
			telechips,pins = "gpma-0\0gpma-1";
			telechips,pin-function = < 0x07 >;
			telechips,input_buffer_enable;
		};

		uart31_rtscts {
			telechips,pins = "gpma-2\0gpma-3";
			telechips,pin-function = < 0x07 >;
			telechips,input_buffer_enable;
		};

		uart32_data {
			telechips,pins = "gpma-6\0gpma-7";
			telechips,pin-function = < 0x07 >;
			telechips,input_buffer_enable;
		};

		uart32_rtscts {
			telechips,pins = "gpma-8\0gpma-9";
			telechips,pin-function = < 0x07 >;
			telechips,input_buffer_enable;
		};

		uart33_data {
			telechips,pins = "gpma-12\0gpma-13";
			telechips,pin-function = < 0x07 >;
			telechips,input_buffer_enable;
		};

		uart33_rtscts {
			telechips,pins = "gpma-14\0gpma-15";
			telechips,pin-function = < 0x07 >;
			telechips,input_buffer_enable;
		};

		uart34_data {
			telechips,pins = "gpma-18\0gpma-19";
			telechips,pin-function = < 0x07 >;
			telechips,input_buffer_enable;
		};

		uart34_rtscts {
			telechips,pins = "gpma-20\0gpma-21";
			telechips,pin-function = < 0x07 >;
			telechips,input_buffer_enable;
		};

		uart35_data {
			telechips,pins = "gpma-24\0gpma-25";
			telechips,pin-function = < 0x07 >;
			telechips,input_buffer_enable;
		};

		uart35_rtscts {
			telechips,pins = "gpma-26\0gpma-27";
			telechips,pin-function = < 0x07 >;
			telechips,input_buffer_enable;
		};

		uart36_data {
			telechips,pins = "gpk-9\0gpk-10";
			telechips,pin-function = < 0x02 >;
			telechips,input_buffer_enable;
		};

		uart37_data {
			telechips,pins = "gpmb-0\0gpmb-1";
			telechips,pin-function = < 0x07 >;
			telechips,input_buffer_enable;
		};

		uart37_rtscts {
			telechips,pins = "gpmb-2\0gpmb-3";
			telechips,pin-function = < 0x07 >;
			telechips,input_buffer_enable;
		};

		uart38_data {
			telechips,pins = "gpmb-6\0gpmb-7";
			telechips,pin-function = < 0x07 >;
			telechips,input_buffer_enable;
		};

		uart38_rtscts {
			telechips,pins = "gpmb-8\0gpmb-9";
			telechips,pin-function = < 0x07 >;
			telechips,input_buffer_enable;
		};

		uart39_data {
			telechips,pins = "gpmb-12\0gpmb-13";
			telechips,pin-function = < 0x07 >;
			telechips,input_buffer_enable;
		};

		uart39_rtscts {
			telechips,pins = "gpmb-14\0gpmb-15";
			telechips,pin-function = < 0x07 >;
			telechips,input_buffer_enable;
		};

		uart40_data {
			telechips,pins = "gpmb-18\0gpmb-19";
			telechips,pin-function = < 0x07 >;
			telechips,input_buffer_enable;
		};

		uart40_rtscts {
			telechips,pins = "gpmb-20\0gpmb-21";
			telechips,pin-function = < 0x07 >;
			telechips,input_buffer_enable;
		};

		uart41_data {
			telechips,pins = "gpmb-24\0gpmb-25";
			telechips,pin-function = < 0x07 >;
			telechips,input_buffer_enable;
		};

		uart41_rtscts {
			telechips,pins = "gpmb-26\0gpmb-27";
			telechips,pin-function = < 0x07 >;
			telechips,input_buffer_enable;
		};

		uart42_data {
			telechips,pins = "gpmc-0\0gpmc-1";
			telechips,pin-function = < 0x07 >;
			telechips,input_buffer_enable;
		};

		uart42_rtscts {
			telechips,pins = "gpmc-2\0gpmb-3";
			telechips,pin-function = < 0x07 >;
			telechips,input_buffer_enable;
		};

		uart43_data {
			telechips,pins = "gpmc-6\0gpmc-7";
			telechips,pin-function = < 0x07 >;
			telechips,input_buffer_enable;
		};

		uart43_rtscts {
			telechips,pins = "gpmc-8\0gpmb-9";
			telechips,pin-function = < 0x07 >;
			telechips,input_buffer_enable;
		};

		uart44_data {
			telechips,pins = "gpmc-12\0gpmc-13";
			telechips,pin-function = < 0x07 >;
			telechips,input_buffer_enable;
		};

		uart44_rtscts {
			telechips,pins = "gpmc-14\0gpmb-15";
			telechips,pin-function = < 0x07 >;
			telechips,input_buffer_enable;
		};

		uart45_data {
			telechips,pins = "gpmc-18\0gpmc-19";
			telechips,pin-function = < 0x07 >;
			telechips,input_buffer_enable;
		};

		uart45_rtscts {
			telechips,pins = "gpmc-20\0gpmb-21";
			telechips,pin-function = < 0x07 >;
			telechips,input_buffer_enable;
		};

		uart46_data {
			telechips,pins = "gpmc-24\0gpmc-25";
			telechips,pin-function = < 0x07 >;
			telechips,input_buffer_enable;
		};

		uart46_rtscts {
			telechips,pins = "gpmc-26\0gpmb-27";
			telechips,pin-function = < 0x07 >;
			telechips,input_buffer_enable;
		};

		i2c12_bus_active {
			telechips,pins = "gpb-21\0gpb-22";
			telechips,pin-function = < 0x08 >;
			telechips,input_buffer_enable;
			telechips,no-pull;
			phandle = < 0x25 >;
		};

		i2c12_bus_sleep {
			telechips,pins = "gpb-21\0gpb-22";
			telechips,pin-function = < 0x00 >;
			telechips,no-pull;
			phandle = < 0x26 >;
		};

		i2c35_bus_active {
			telechips,pins = "gpmc-4\0gpmc-5";
			telechips,pin-function = < 0x08 >;
			telechips,input_buffer_enable;
			telechips,no-pull;
			phandle = < 0x22 >;
		};

		i2c35_bus_sleep {
			telechips,pins = "gpmc-4\0gpmc-5";
			telechips,pin-function = < 0x00 >;
			telechips,no-pull;
			phandle = < 0x23 >;
		};

		isp0_uart_tx {
			telechips,pins = "gpmb-0";
			telechips,pin-function = < 0x05 >;
			telechips,output-high;
			telechips,input_buffer_disable;
		};

		isp0_uart_rx {
			telechips,pins = "gpmb-1";
			telechips,pin-function = < 0x05 >;
			telechips,input-enable;
			telechips,input_buffer_enable;
		};

		isp1_uart_tx {
			telechips,pins = "gpmb-6";
			telechips,pin-function = < 0x05 >;
			telechips,output-high;
			telechips,input_buffer_disable;
		};

		isp1_uart_rx {
			telechips,pins = "gpmb-7";
			telechips,pin-function = < 0x05 >;
			telechips,input-enable;
			telechips,input_buffer_enable;
		};

		isp2_uart_tx {
			telechips,pins = "gpmb-12";
			telechips,pin-function = < 0x05 >;
			telechips,output-high;
			telechips,input_buffer_disable;
		};

		isp2_uart_rx {
			telechips,pins = "gpmb-13";
			telechips,pin-function = < 0x05 >;
			telechips,input-enable;
			telechips,input_buffer_enable;
		};

		isp3_uart_tx {
			telechips,pins = "gpmb-24";
			telechips,pin-function = < 0x05 >;
			telechips,output-high;
			telechips,input_buffer_disable;
		};

		isp3_uart_rx {
			telechips,pins = "gpmb-25";
			telechips,pin-function = < 0x05 >;
			telechips,input-enable;
			telechips,input_buffer_enable;
		};

		cam0_8bit_idle {
			telechips,pins = "gpa-0\0gpa-1\0gpa-2\0gpa-11\0gpa-12\0gpa-3\0gpa-4\0gpa-5\0gpa-6\0gpa-7\0gpa-8\0gpa-9\0gpa-10";
			telechips,pin-function = < 0x00 >;
			telechips,output-low;
		};

		cam0_16bit_idle {
			telechips,pins = "gpa-0\0gpa-3\0gpa-4\0gpa-5\0gpa-6\0gpa-7\0gpa-8\0gpa-9\0gpa-10\0gpa-13\0gpa-14\0gpa-15\0gpa-16\0gpa-17\0gpa-18\0gpa-19\0gpa-20";
			telechips,pin-function = < 0x00 >;
			telechips,output-low;
		};

		cam0_clk {
			telechips,pins = "gpa-0";
			telechips,pin-function = < 0x03 >;
			telechips,drive-strength = < 0x03 >;
			telechips,input_buffer_enable;
			phandle = < 0x27 >;
		};

		cam0_hsync {
			telechips,pins = "gpa-1";
			telechips,pin-function = < 0x03 >;
			telechips,drive-strength = < 0x03 >;
			telechips,input_buffer_enable;
		};

		cam0_vsync {
			telechips,pins = "gpa-2";
			telechips,pin-function = < 0x03 >;
			telechips,drive-strength = < 0x03 >;
			telechips,input_buffer_enable;
		};

		cam0_fld {
			telechips,pins = "gpa-11";
			telechips,pin-function = < 0x03 >;
			telechips,drive-strength = < 0x03 >;
			telechips,input_buffer_enable;
		};

		cam0_de {
			telechips,pins = "gpa-12";
			telechips,pin-function = < 0x03 >;
			telechips,drive-strength = < 0x03 >;
			telechips,input_buffer_enable;
		};

		cam0_data_8bit {
			telechips,pins = "gpa-3\0gpa-4\0gpa-5\0gpa-6\0gpa-7\0gpa-8\0gpa-9\0gpa-10";
			telechips,pin-function = < 0x03 >;
			telechips,drive-strength = < 0x03 >;
			telechips,input_buffer_enable;
			phandle = < 0x28 >;
		};

		cam0_data_16bit {
			telechips,pins = "gpa-3\0gpa-4\0gpa-5\0gpa-6\0gpa-7\0gpa-8\0gpa-9\0gpa-10\0gpa-13\0gpa-14\0gpa-15\0gpa-16\0gpa-17\0gpa-18\0gpa-19\0gpa-20";
			telechips,pin-function = < 0x03 >;
			telechips,drive-strength = < 0x03 >;
			telechips,input_buffer_enable;
		};
	};

	gpio@14200000 {
		compatible = "telechips,tcc-gpio";
		reg = < 0x00 0x14200000 0x00 0x7c0 >;
		sc-firmware = < 0x13 >;
		interrupts = < 0x00 0x00 0x04 0x00 0x01 0x04 0x00 0x02 0x04 0x00 0x03 0x04 0x00 0x04 0x04 0x00 0x05 0x04 0x00 0x06 0x04 0x00 0x07 0x04 0x00 0x08 0x04 0x00 0x09 0x04 0x00 0x0a 0x04 0x00 0x0b 0x04 0x00 0x0c 0x04 0x00 0x0d 0x04 0x00 0x0e 0x04 0x00 0x0f 0x04 0x00 0x10 0x04 0x00 0x11 0x04 0x00 0x12 0x04 0x00 0x13 0x04 0x00 0x14 0x04 0x00 0x15 0x04 0x00 0x16 0x04 0x00 0x17 0x04 0x00 0x18 0x04 0x00 0x19 0x04 0x00 0x1a 0x04 0x00 0x1b 0x04 0x00 0x1c 0x04 0x00 0x1d 0x04 0x00 0x1e 0x04 0x00 0x1f 0x04 >;

		gpa {
			reg-offset = < 0x00 >;
			gpio-controller;
			#gpio-cells = < 0x02 >;
			interrupt-controller;
			#interrupt-cells = < 0x02 >;
			source-num = < 0x01 0x00 0x01 0x20 >;
			label = "gpioa";
			gpio-ranges = < 0x14 0x00 0x00 0x20 >;
		};

		gpb {
			reg-offset = < 0x40 >;
			gpio-controller;
			#gpio-cells = < 0x02 >;
			interrupt-controller;
			#interrupt-cells = < 0x02 >;
			source-num = < 0x01 0x00 0x21 0x1d >;
			label = "gpiob";
			gpio-ranges = < 0x14 0x00 0x20 0x1d >;
			phandle = < 0x29 >;
		};

		gpc {
			reg-offset = < 0x80 >;
			gpio-controller;
			#gpio-cells = < 0x02 >;
			interrupt-controller;
			#interrupt-cells = < 0x02 >;
			source-num = < 0x01 0x00 0x3e 0x1e >;
			label = "gpioc";
			gpio-ranges = < 0x14 0x00 0x3d 0x1e >;
		};

		gpe {
			reg-offset = < 0x100 >;
			gpio-controller;
			#gpio-cells = < 0x02 >;
			interrupt-controller;
			#interrupt-cells = < 0x02 >;
			source-num = < 0x01 0x00 0x5c 0x14 >;
			label = "gpioe";
			gpio-ranges = < 0x14 0x00 0x5b 0x14 >;
		};

		gpg {
			reg-offset = < 0x180 >;
			gpio-controller;
			#gpio-cells = < 0x02 >;
			interrupt-controller;
			#interrupt-cells = < 0x02 >;
			source-num = < 0x01 0x00 0x70 0x0b >;
			label = "gpiog";
			gpio-ranges = < 0x14 0x00 0x6f 0x0b >;
			phandle = < 0x2e >;
		};

		gph {
			reg-offset = < 0x640 >;
			gpio-controller;
			#gpio-cells = < 0x02 >;
			interrupt-controller;
			#interrupt-cells = < 0x02 >;
			source-num = < 0x01 0x00 0x7b 0x0c >;
			label = "gpioh";
			gpio-ranges = < 0x14 0x00 0x7a 0x0c >;
			phandle = < 0x50 >;
		};

		gpk {
			reg-offset = < 0x800 >;
			gpio-controller;
			#gpio-cells = < 0x02 >;
			interrupt-controller;
			#interrupt-cells = < 0x02 >;
			source-num = < 0xff >;
			label = "gpiok";
			gpio-ranges = < 0x14 0x00 0x86 0x13 >;
		};

		gpsd0 {
			reg-offset = < 0x200 >;
			gpio-controller;
			#gpio-cells = < 0x02 >;
			interrupt-controller;
			#interrupt-cells = < 0x02 >;
			source-num = < 0x01 0x00 0xa6 0x0f >;
			label = "gpiosd0";
			gpio-ranges = < 0x14 0x00 0x99 0x0f >;
		};

		gpsd1 {
			reg-offset = < 0x240 >;
			gpio-controller;
			#gpio-cells = < 0x02 >;
			interrupt-controller;
			#interrupt-cells = < 0x02 >;
			source-num = < 0x01 0x00 0xb5 0x0b >;
			label = "gpiosd1";
			gpio-ranges = < 0x14 0x00 0xa8 0x0b >;
		};

		gpsd2 {
			reg-offset = < 0x600 >;
			gpio-controller;
			#gpio-cells = < 0x02 >;
			interrupt-controller;
			#interrupt-cells = < 0x02 >;
			source-num = < 0x01 0x00 0xc0 0x0a >;
			label = "gpiosd2";
			gpio-ranges = < 0x14 0x00 0xb3 0x0a >;
		};

		gpma {
			reg-offset = < 0x6c0 >;
			gpio-controller;
			#gpio-cells = < 0x02 >;
			interrupt-controller;
			#interrupt-cells = < 0x02 >;
			source-num = < 0x01 0x00 0x87 0x1e >;
			label = "gpioma";
			gpio-ranges = < 0x14 0x00 0xbd 0x1e >;
			phandle = < 0x31 >;
		};

		gpmb {
			reg-offset = < 0x700 >;
			gpio-controller;
			#gpio-cells = < 0x02 >;
			interrupt-controller;
			#interrupt-cells = < 0x02 >;
			source-num = < 0x01 0x00 0xca 0x1e >;
			label = "gpiomb";
			gpio-ranges = < 0x14 0x00 0xdb 0x20 >;
			phandle = < 0x51 >;
		};

		gpmc {
			reg-offset = < 0x740 >;
			gpio-controller;
			#gpio-cells = < 0x02 >;
			interrupt-controller;
			#interrupt-cells = < 0x02 >;
			source-num = < 0x01 0x00 0xe4 0x1e >;
			label = "gpiomc";
			gpio-ranges = < 0x14 0x00 0xfb 0x1e >;
			phandle = < 0x24 >;
		};

		gpmd {
			reg-offset = < 0x780 >;
			gpio-controller;
			#gpio-cells = < 0x02 >;
			interrupt-controller;
			#interrupt-cells = < 0x02 >;
			source-num = < 0x02 0x08 0xfc 0x02 0x10 0xfe 0x02 >;
			label = "gpiomd";
			gpio-ranges = < 0x14 0x00 0x119 0x12 >;
			phandle = < 0x3e >;
		};
	};

	access_control@16689020 {
		reg = < 0x00 0x16689020 0x00 0x20 >;
		access-control0 = < 0x20000000 0xc0000000 >;
		access-control1 = < 0x16600000 0x16600400 >;
		access-control2 = < 0x00 0x00 >;
		access-control3 = < 0x00 0x00 >;
		phandle = < 0x16 >;
	};

	access_control@16689040 {
		reg = < 0x00 0x16689040 0x00 0x20 >;
		access-control0 = < 0x20000000 0xc0000000 >;
		access-control1 = < 0x16610000 0x16610400 >;
		access-control2 = < 0x00 0x00 >;
		access-control3 = < 0x00 0x00 >;
		phandle = < 0x17 >;
	};

	access_control@16689060 {
		reg = < 0x00 0x16689060 0x00 0x20 >;
		access-control0 = < 0x20000000 0xc0000000 >;
		access-control1 = < 0x16620000 0x16620400 >;
		access-control2 = < 0x00 0x00 >;
		access-control3 = < 0x00 0x00 >;
		phandle = < 0x18 >;
	};

	access_control@16689080 {
		reg = < 0x00 0x16689080 0x00 0x20 >;
		access-control0 = < 0x20000000 0xc0000000 >;
		access-control1 = < 0x16630000 0x16630400 >;
		access-control2 = < 0x00 0x00 >;
		access-control3 = < 0x00 0x00 >;
		phandle = < 0x19 >;
	};

	access_control@166890A0 {
		reg = < 0x00 0x166890a0 0x00 0x20 >;
		access-control0 = < 0x20000000 0xc0000000 >;
		access-control1 = < 0x16640000 0x16640400 >;
		access-control2 = < 0x00 0x00 >;
		access-control3 = < 0x00 0x00 >;
		phandle = < 0x1a >;
	};

	access_control@166890C0 {
		reg = < 0x00 0x166890c0 0x00 0x20 >;
		access-control0 = < 0x20000000 0xc0000000 >;
		access-control1 = < 0x16650000 0x16650400 >;
		access-control2 = < 0x00 0x00 >;
		access-control3 = < 0x00 0x00 >;
		phandle = < 0x1b >;
	};

	access_control@166890E0 {
		reg = < 0x00 0x166890e0 0x00 0x20 >;
		access-control0 = < 0x20000000 0xc0000000 >;
		access-control1 = < 0x16660000 0x16660400 >;
		access-control2 = < 0x00 0x00 >;
		access-control3 = < 0x00 0x00 >;
		phandle = < 0x1c >;
	};

	access_control@16689100 {
		reg = < 0x00 0x16689100 0x00 0x20 >;
		access-control0 = < 0x20000000 0xc0000000 >;
		access-control1 = < 0x16670000 0x16670400 >;
		access-control2 = < 0x00 0x00 >;
		access-control3 = < 0x00 0x00 >;
		phandle = < 0x1d >;
	};

	udma@16680000 {
		compatible = "arm,pl081\0arm,primecell";
		reg = < 0x00 0x16680000 0x00 0x1000 >;
		interrupts = < 0x00 0x54 0x04 >;
		channel-priority = < 0x00 >;
		clocks = < 0x15 0x90 >;
		clock-names = "apb_pclk";
		lli-bus-interface-ahb1;
		lli-bus-interface-ahb2;
		mem-bus-interface-ahb2;
		memcpy-burst-size = < 0x100 >;
		memcpy-bus-width = < 0x20 >;
		#dma-cells = < 0x02 >;
		access-control = < 0x16 >;
		status = "disabled";
	};

	udma@16681000 {
		compatible = "arm,pl081\0arm,primecell";
		reg = < 0x00 0x16681000 0x00 0x1000 >;
		interrupts = < 0x00 0x55 0x04 >;
		channel-priority = < 0x00 >;
		clocks = < 0x15 0x91 >;
		clock-names = "apb_pclk";
		lli-bus-interface-ahb1;
		lli-bus-interface-ahb2;
		mem-bus-interface-ahb2;
		memcpy-burst-size = < 0x100 >;
		memcpy-bus-width = < 0x20 >;
		#dma-cells = < 0x02 >;
		access-control = < 0x17 >;
		status = "disabled";
	};

	udma@16682000 {
		compatible = "arm,pl081\0arm,primecell";
		reg = < 0x00 0x16682000 0x00 0x1000 >;
		interrupts = < 0x00 0x56 0x04 >;
		channel-priority = < 0x00 >;
		clocks = < 0x15 0x92 >;
		clock-names = "apb_pclk";
		lli-bus-interface-ahb1;
		lli-bus-interface-ahb2;
		mem-bus-interface-ahb2;
		memcpy-burst-size = < 0x100 >;
		memcpy-bus-width = < 0x20 >;
		#dma-cells = < 0x02 >;
		access-control = < 0x18 >;
		status = "disabled";
	};

	udma@16683000 {
		compatible = "arm,pl081\0arm,primecell";
		reg = < 0x00 0x16683000 0x00 0x1000 >;
		interrupts = < 0x00 0x57 0x04 >;
		channel-priority = < 0x00 >;
		clocks = < 0x15 0x93 >;
		clock-names = "apb_pclk";
		lli-bus-interface-ahb1;
		lli-bus-interface-ahb2;
		mem-bus-interface-ahb2;
		memcpy-burst-size = < 0x100 >;
		memcpy-bus-width = < 0x20 >;
		#dma-cells = < 0x02 >;
		access-control = < 0x19 >;
		status = "disabled";
	};

	udma@16684000 {
		compatible = "arm,pl081\0arm,primecell";
		reg = < 0x00 0x16684000 0x00 0x1000 >;
		interrupts = < 0x00 0x6a 0x04 >;
		channel-priority = < 0x00 >;
		clocks = < 0x15 0x96 >;
		clock-names = "apb_pclk";
		lli-bus-interface-ahb1;
		lli-bus-interface-ahb2;
		mem-bus-interface-ahb2;
		memcpy-burst-size = < 0x100 >;
		memcpy-bus-width = < 0x20 >;
		#dma-cells = < 0x02 >;
		access-control = < 0x1a >;
		status = "disabled";
	};

	udma@16685000 {
		compatible = "arm,pl081\0arm,primecell";
		reg = < 0x00 0x16685000 0x00 0x1000 >;
		interrupts = < 0x00 0x6b 0x04 >;
		channel-priority = < 0x00 >;
		clocks = < 0x15 0x97 >;
		clock-names = "apb_pclk";
		lli-bus-interface-ahb1;
		lli-bus-interface-ahb2;
		mem-bus-interface-ahb2;
		memcpy-burst-size = < 0x100 >;
		memcpy-bus-width = < 0x20 >;
		#dma-cells = < 0x02 >;
		access-control = < 0x1b >;
		status = "disabled";
	};

	udma@16686000 {
		compatible = "arm,pl081\0arm,primecell";
		reg = < 0x00 0x16686000 0x00 0x1000 >;
		interrupts = < 0x00 0x6c 0x04 >;
		channel-priority = < 0x00 >;
		clocks = < 0x15 0x98 >;
		clock-names = "apb_pclk";
		lli-bus-interface-ahb1;
		lli-bus-interface-ahb2;
		mem-bus-interface-ahb2;
		memcpy-burst-size = < 0x100 >;
		memcpy-bus-width = < 0x20 >;
		#dma-cells = < 0x02 >;
		access-control = < 0x1c >;
		status = "disabled";
	};

	udma@16687000 {
		compatible = "arm,pl081\0arm,primecell";
		reg = < 0x00 0x16687000 0x00 0x1000 >;
		interrupts = < 0x00 0x6d 0x04 >;
		channel-priority = < 0x00 >;
		clocks = < 0x15 0x99 >;
		clock-names = "apb_pclk";
		lli-bus-interface-ahb1;
		lli-bus-interface-ahb2;
		mem-bus-interface-ahb2;
		memcpy-burst-size = < 0x100 >;
		memcpy-bus-width = < 0x20 >;
		#dma-cells = < 0x02 >;
		access-control = < 0x1d >;
		status = "disabled";
	};

	serial@16600000 {
		compatible = "arm,pl011\0arm,primecell";
		reg = < 0x00 0x16600000 0x00 0x1000 >;
		config-reg = < 0x16689000 0x08 0x09 >;
		arm,primecell-periphid = < 0x1feff7 >;
		sc-firmware = < 0x13 >;
		interrupts = < 0x00 0x58 0x04 >;
		clocks = < 0x1e 0x14000748 0x15 0x80 >;
		clock-names = "uartclk\0apb_pclk";
		status = "disabled";
	};

	serial@16610000 {
		compatible = "arm,pl011\0arm,primecell";
		reg = < 0x00 0x16610000 0x00 0x1000 >;
		config-reg = < 0x16689000 0x08 0x09 >;
		arm,primecell-periphid = < 0x1feff7 >;
		sc-firmware = < 0x13 >;
		interrupts = < 0x00 0x59 0x04 >;
		clocks = < 0x1e 0x1400074c 0x15 0x81 >;
		clock-names = "uartclk\0apb_pclk";
		assigned-clocks = < 0x1e 0x1400074c >;
		assigned-clock-rates = < 0x2dc6c00 >;
		status = "disabled";
	};

	serial@16620000 {
		compatible = "arm,pl011\0arm,primecell";
		reg = < 0x00 0x16620000 0x00 0x1000 >;
		config-reg = < 0x16689000 0x08 0x09 >;
		arm,primecell-periphid = < 0x1feff7 >;
		sc-firmware = < 0x13 >;
		interrupts = < 0x00 0x5a 0x04 >;
		clocks = < 0x1e 0x14000750 0x15 0x82 >;
		clock-names = "uartclk\0apb_pclk";
		assigned-clocks = < 0x1e 0x14000750 >;
		assigned-clock-rates = < 0x2dc6c00 >;
		status = "disabled";
	};

	serial@16630000 {
		compatible = "arm,pl011\0arm,primecell";
		reg = < 0x00 0x16630000 0x00 0x1000 >;
		config-reg = < 0x16689000 0x08 0x09 >;
		arm,primecell-periphid = < 0x1feff7 >;
		sc-firmware = < 0x13 >;
		interrupts = < 0x00 0x5b 0x04 >;
		clocks = < 0x1e 0x14000754 0x15 0x83 >;
		clock-names = "uartclk\0apb_pclk";
		assigned-clocks = < 0x1e 0x14000754 >;
		assigned-clock-rates = < 0x2dc6c00 >;
		status = "disabled";
	};

	serial@16640000 {
		compatible = "arm,pl011\0arm,primecell";
		reg = < 0x00 0x16640000 0x00 0x1000 >;
		config-reg = < 0x16689000 0x08 0x09 >;
		arm,primecell-periphid = < 0x1feff7 >;
		sc-firmware = < 0x13 >;
		interrupts = < 0x00 0x45 0x04 >;
		clocks = < 0x1e 0x14000780 0x15 0x84 >;
		clock-names = "uartclk\0apb_pclk";
		assigned-clocks = < 0x1e 0x14000780 >;
		assigned-clock-rates = < 0x2dc6c00 >;
		status = "okay";
		pinctrl-names = "default\0sleep";
		pinctrl-0 = < 0x1f >;
		pinctrl-1 = < 0x1f >;
	};

	serial@16650000 {
		compatible = "arm,pl011\0arm,primecell";
		reg = < 0x00 0x16650000 0x00 0x1000 >;
		config-reg = < 0x16689000 0x08 0x09 >;
		arm,primecell-periphid = < 0x1feff7 >;
		sc-firmware = < 0x13 >;
		interrupts = < 0x00 0x6f 0x04 >;
		clocks = < 0x1e 0x140007c8 0x15 0x85 >;
		clock-names = "uartclk\0apb_pclk";
		assigned-clocks = < 0x1e 0x140007c8 >;
		assigned-clock-rates = < 0x2dc6c00 >;
		status = "disabled";
	};

	serial@16660000 {
		compatible = "arm,pl011\0arm,primecell";
		reg = < 0x00 0x16660000 0x00 0x1000 >;
		config-reg = < 0x16689000 0x08 0x09 >;
		arm,primecell-periphid = < 0x1feff7 >;
		sc-firmware = < 0x13 >;
		interrupts = < 0x00 0x70 0x04 >;
		clocks = < 0x1e 0x140007cc 0x15 0x86 >;
		clock-names = "uartclk\0apb_pclk";
		assigned-clocks = < 0x1e 0x140007cc >;
		assigned-clock-rates = < 0x2dc6c00 >;
		status = "disabled";
	};

	serial@16670000 {
		compatible = "arm,pl011\0arm,primecell";
		reg = < 0x00 0x16670000 0x00 0x1000 >;
		config-reg = < 0x16689000 0x08 0x09 >;
		arm,primecell-periphid = < 0x1feff7 >;
		sc-firmware = < 0x13 >;
		interrupts = < 0x00 0x71 0x04 >;
		clocks = < 0x1e 0x140007d0 0x15 0x87 >;
		clock-names = "uartclk\0apb_pclk";
		assigned-clocks = < 0x1e 0x140007d0 >;
		assigned-clock-rates = < 0x2dc6c00 >;
		status = "disabled";
	};

	cb_wdt_main {
		compatible = "telechips,tcc-cb-wdt";
		reg = < 0x00 0x17020000 0x00 0x10000 0x00 0x17010000 0x00 0x10000 >;
		clocks = < 0x1e 0x14000900 >;
		clock-names = "clk_wdt";
		assigned-clocks = < 0x1e 0x14000900 >;
		assigned-clock-rates = < 0xb71b00 >;
		interrupts = < 0x00 0xb7 0x04 >;
		kick-interval = < 0x05 >;
		timeout-sec = < 0x14 >;
		status = "disabled";
	};

	cb_wdt_sub {
		compatible = "telechips,tcc-cb-wdt";
		reg = < 0x00 0x17060000 0x00 0x10000 0x00 0x17050000 0x00 0x10000 >;
		clocks = < 0x1e 0x14000900 >;
		clock-names = "clk_wdt";
		assigned-clocks = < 0x1e 0x14000900 >;
		assigned-clock-rates = < 0xb71b00 >;
		interrupts = < 0x00 0xa2 0x04 >;
		kick-interval = < 0x05 >;
		timeout-sec = < 0x14 >;
	};

	access_control@16050000 {
		reg = < 0x00 0x16050000 0x00 0x20 >;
		access-control0 = < 0x20000000 0xc0000000 >;
		access-control1 = < 0x00 0x00 >;
		access-control2 = < 0x00 0x00 >;
		access-control3 = < 0x00 0x00 >;
	};

	access_control@16050020 {
		reg = < 0x00 0x16050020 0x00 0x20 >;
		access-control0 = < 0x20000000 0xc0000000 >;
		access-control1 = < 0x00 0x00 >;
		access-control2 = < 0x00 0x00 >;
		access-control3 = < 0x00 0x00 >;
	};

	access_control@16050040 {
		reg = < 0x00 0x16050040 0x00 0x20 >;
		access-control0 = < 0x20000000 0xc0000000 >;
		access-control1 = < 0x00 0x00 >;
		access-control2 = < 0x00 0x00 >;
		access-control3 = < 0x00 0x00 >;
	};

	access_control@16498000 {
		reg = < 0x00 0x16498000 0x00 0x20 >;
		access-control0 = < 0x20000000 0xc0000000 >;
		access-control1 = < 0x00 0x00 >;
		access-control2 = < 0x00 0x00 >;
		access-control3 = < 0x00 0x00 >;
	};

	dma@16020000 {
		compatible = "telechips,tcc805x-dma";
		reg = < 0x00 0x16020000 0x00 0x94 0x00 0x1605101c 0x00 0x04 >;
		interrupts = < 0x00 0x33 0x04 >;
		#dma-cells = < 0x02 >;
		dma-channels = < 0x03 >;
		dma-requests = < 0x20 >;
		channel-priority = < 0x00 >;
		clocks = < 0x15 0x47 >;
		clock-names = "dmac0";
		status = "disabled";
	};

	dma@16021000 {
		compatible = "telechips,tcc805x-dma";
		reg = < 0x00 0x16021000 0x00 0x94 0x00 0x16051020 0x00 0x04 >;
		interrupts = < 0x00 0x34 0x04 >;
		#dma-cells = < 0x02 >;
		dma-channels = < 0x03 >;
		dma-requests = < 0x20 >;
		channel-priority = < 0x00 >;
		clocks = < 0x15 0x48 >;
		clock-names = "dmac1";
		status = "disabled";
	};

	dma@16022000 {
		compatible = "telechips,tcc805x-dma";
		reg = < 0x00 0x16022000 0x00 0x94 0x00 0x16051024 0x00 0x04 >;
		interrupts = < 0x00 0x35 0x04 >;
		#dma-cells = < 0x02 >;
		dma-channels = < 0x03 >;
		dma-requests = < 0x20 >;
		channel-priority = < 0x00 >;
		clocks = < 0x15 0x49 >;
		clock-names = "dmac2";
		status = "disabled";
	};

	dma@16490000 {
		compatible = "telechips,tcc805x-dma";
		reg = < 0x00 0x16490000 0x00 0x94 >;
		interrupts = < 0x00 0x36 0x04 >;
		#dma-cells = < 0x02 >;
		dma-channels = < 0x03 >;
		dma-requests = < 0x20 >;
		channel-priority = < 0x00 >;
		clocks = < 0x15 0xa0 >;
		clock-names = "dmac3";
		status = "disabled";
	};

	tcc_sc_mmc {
		compatible = "telechips,tcc805x-sc-mmc";
		status = "okay";
		sc-firmware = < 0x13 >;
		max-frequency = < 0xbebc200 >;
		bus-width = < 0x08 >;
		no-sdio;
		no-sd;
		non-removable;
		keep-power-in-suspend;
		disable-wp;
		mmc-hs400-1_8v;
		mmc-hs400-enhanced-strobe;
		vqmmc-supply = < 0x20 >;
	};

	vqmmc_emmc {
		compatible = "regulator-fixed";
		regulator-name = "vqmmc_emmc";
		regulator-min-microvolt = < 0x1b7740 >;
		regulator-max-microvolt = < 0x1b7740 >;
		regulator-always-on;
		phandle = < 0x20 >;
	};

	sdhc@1D2A0000 {
		compatible = "telechips,tcc805x-sdhci";
		reg = < 0x00 0x1d2a0000 0x00 0x100 0x00 0x1d2d1000 0x00 0x200 0x00 0x00 0x00 0x00 0x00 0x1d2d10fc 0x00 0x04 >;
		interrupts = < 0x00 0x146 0x04 >;
		max-frequency = < 0xbebc200 >;
		bus-width = < 0x04 >;
		controller-id = < 0x00 >;
		status = "disabled";
	};

	sdhc@16450000 {
		compatible = "telechips,tcc805x-sdhci";
		reg = < 0x00 0x16450000 0x00 0x100 0x00 0x16470050 0x00 0x200 0x00 0x00 0x00 0x00 0x00 0x164700fc 0x00 0x04 >;
		interrupts = < 0x00 0x4b 0x04 >;
		clocks = < 0x1e 0x14000708 0x15 0xa3 >;
		clock-names = "mmc_fclk\0mmc_hclk";
		max-frequency = < 0xbebc200 >;
		bus-width = < 0x04 >;
		controller-id = < 0x01 >;
		status = "disabled";
	};

	sdhc1_pwrseq {
	};

	sdhc@16460000 {
		compatible = "telechips,tcc805x-sdhci";
		reg = < 0x00 0x16460000 0x00 0x100 0x00 0x164700a0 0x00 0x200 0x00 0x00 0x00 0x00 0x00 0x164700fc 0x00 0x04 >;
		interrupts = < 0x00 0x4c 0x04 >;
		clocks = < 0x1e 0x1400070c 0x15 0xa4 >;
		clock-names = "mmc_fclk\0mmc_hclk";
		max-frequency = < 0xbebc200 >;
		bus-width = < 0x04 >;
		controller-id = < 0x02 >;
		status = "disabled";
	};

	sdhc2_pwrseq {
	};

	tcc_sc_ufs {
		compatible = "telechips,tcc805x-sc-ufs";
		status = "okay";
		sc-firmware = < 0x13 >;
	};

	adc@1b700000 {
		compatible = "telechips,tcc805x-adc";
		reg = < 0x00 0x1b700000 0x00 0xac 0x00 0x1b931088 0x00 0x04 >;
		#io-channel-cells = < 0x01 >;
		status = "disabled";
	};

	i2c@16300000 {
		compatible = "telechips,tcc805x-i2c-v3";
		reg = < 0x00 0x16300000 0x00 0x28 0x00 0x163c0000 0x00 0x14 0x00 0x16340000 0x00 0x04 >;
		interrupts = < 0x00 0x3d 0x04 >;
		#address-cells = < 0x01 >;
		#size-cells = < 0x00 >;
		clocks = < 0x1e 0x14000738 0x15 0x5d 0x10 0x1400002c >;
		clock-frequency = < 0x61a80 >;
		resets = < 0x21 0x5d >;
		reset-names = "iobus-i2cM0";
		port-mux = < 0xff >;
		status = "disabled";
	};

	i2c@16310000 {
		compatible = "telechips,tcc805x-i2c-v3";
		reg = < 0x00 0x16310000 0x00 0x28 0x00 0x163c0000 0x00 0x14 0x00 0x16350000 0x00 0x04 >;
		interrupts = < 0x00 0x3e 0x04 >;
		#address-cells = < 0x01 >;
		#size-cells = < 0x00 >;
		clocks = < 0x1e 0x1400073c 0x15 0x5e 0x10 0x1400002c >;
		clock-frequency = < 0x61a80 >;
		resets = < 0x21 0x5e >;
		reset-names = "iobus-i2cM1";
		port-mux = < 0xff >;
		status = "disabled";
	};

	i2c@16320000 {
		compatible = "telechips,tcc805x-i2c-v3";
		reg = < 0x00 0x16320000 0x00 0x28 0x00 0x163c0000 0x00 0x14 0x00 0x16360000 0x00 0x04 >;
		interrupts = < 0x00 0x3f 0x04 >;
		#address-cells = < 0x01 >;
		#size-cells = < 0x00 >;
		clocks = < 0x1e 0x14000740 0x15 0x5f 0x10 0x1400002c >;
		clock-frequency = < 0x61a80 >;
		resets = < 0x21 0x5f >;
		reset-names = "iobus-i2cM2";
		port-mux = < 0xff >;
		status = "disabled";
	};

	i2c@16330000 {
		compatible = "telechips,tcc805x-i2c-v3";
		reg = < 0x00 0x16330000 0x00 0x28 0x00 0x163c0000 0x00 0x14 0x00 0x16370000 0x00 0x100 >;
		interrupts = < 0x00 0x40 0x04 >;
		#address-cells = < 0x01 >;
		#size-cells = < 0x00 >;
		clocks = < 0x1e 0x14000744 0x15 0x60 0x10 0x1400002c >;
		clock-frequency = < 0x61a80 >;
		resets = < 0x21 0x60 >;
		reset-names = "iobus-i2cM3";
		port-mux = < 0xff >;
		status = "disabled";
	};

	i2c@16340000 {
		compatible = "telechips,tcc805x-i2c-v3";
		reg = < 0x00 0x16340000 0x00 0x28 0x00 0x163c0000 0x00 0x14 0x00 0x16300000 0x00 0x04 >;
		interrupts = < 0x00 0x3d 0x04 >;
		#address-cells = < 0x01 >;
		#size-cells = < 0x00 >;
		clocks = < 0x1e 0x14000738 0x15 0x7c 0x10 0x1400002c >;
		clock-frequency = < 0x61a80 >;
		resets = < 0x21 0x7c >;
		reset-names = "iobus-i2cM4";
		port-mux = < 0xff >;
		status = "disabled";
	};

	i2c@16350000 {
		compatible = "telechips,tcc805x-i2c-v3";
		reg = < 0x00 0x16350000 0x00 0x28 0x00 0x163c0000 0x00 0x14 0x00 0x16310000 0x00 0x04 >;
		interrupts = < 0x00 0x3e 0x04 >;
		#address-cells = < 0x01 >;
		#size-cells = < 0x00 >;
		clocks = < 0x1e 0x1400073c 0x15 0x7d 0x10 0x1400002c >;
		clock-frequency = < 0x61a80 >;
		resets = < 0x21 0x7d >;
		reset-names = "iobus-i2cM5";
		port-mux = < 0xff >;
		status = "disabled";
	};

	i2c@16360000 {
		compatible = "telechips,tcc805x-i2c-v3";
		reg = < 0x00 0x16360000 0x00 0x28 0x00 0x163c0000 0x00 0x14 0x00 0x16320000 0x00 0x04 >;
		interrupts = < 0x00 0x3f 0x04 >;
		#address-cells = < 0x01 >;
		#size-cells = < 0x00 >;
		clocks = < 0x1e 0x14000740 0x15 0x7e 0x10 0x1400002c >;
		clock-frequency = < 0x61a80 >;
		resets = < 0x21 0x7e >;
		reset-names = "iobus-i2cM6";
		port-mux = < 0x23 >;
		status = "disabled";
		pinctrl-names = "default\0sleep";
		pinctrl-0 = < 0x22 >;
		pinctrl-1 = < 0x23 >;

		arxxxx_1@50 {
			status = "disabled";
			compatible = "tcc-onnn,arxxxx";
			reg = < 0x50 >;
		};

		ar0147_1@10 {
			status = "disabled";
			compatible = "tcc-onnn,ar0147";
			reg = < 0x10 >;
		};

		ar0820_1@10 {
			status = "disabled";
			compatible = "tcc-onnn,ar0820";
			reg = < 0x10 >;
		};

		cxd5700_1@18 {
			status = "disabled";
			compatible = "tcc-sony,cxd5700";
			reg = < 0x18 >;
		};

		max96701_1@40 {
			status = "disabled";
			compatible = "tcc-maxim,max96701";
			reg = < 0x40 >;
		};

		max9275_1@40 {
			status = "disabled";
			compatible = "tcc-maxim,max9275";
			reg = < 0x40 >;
		};

		max9295_1@40 {
			status = "disabled";
			compatible = "tcc-maxim,max9295";
			reg = < 0x40 >;
		};

		max9286_1@48 {
			status = "disabled";
			compatible = "tcc-maxim,max9286";
			pwd-gpios = < 0x24 0x00 0x01 >;
			reg = < 0x48 >;
		};

		max96712_1@2a {
			status = "disabled";
			compatible = "tcc-maxim,max96712";
			pwd-gpios = < 0x24 0x00 0x01 >;
			reg = < 0x2a >;
		};
	};

	i2c@16370000 {
		compatible = "telechips,tcc805x-i2c-v3";
		reg = < 0x00 0x16370000 0x00 0x100 0x00 0x163c0000 0x00 0x14 0x00 0x16330000 0x00 0x04 >;
		interrupts = < 0x00 0x40 0x04 >;
		#address-cells = < 0x01 >;
		#size-cells = < 0x00 >;
		clocks = < 0x1e 0x14000744 0x15 0x7f 0x10 0x1400002c >;
		clock-frequency = < 0x61a80 >;
		resets = < 0x21 0x7f >;
		reset-names = "iobus-i2cM7";
		port-mux = < 0x0c >;
		status = "okay";
		pinctrl-names = "default\0sleep";
		pinctrl-0 = < 0x25 >;
		pinctrl-1 = < 0x26 >;

		adv7182@21 {
			status = "okay";
			compatible = "tcc-adi,adv7182";
			pinctrl-names = "default";
			pinctrl-0 = < 0x27 0x28 >;
			rst-gpios = < 0x29 0x0e 0x00 >;
			reg = < 0x21 >;

			port {

				endpoint {
					remote-endpoint = < 0x2a >;
					io-direction = "output";
					bus-width = < 0x08 >;
					phandle = < 0x81 >;
				};
			};
		};

		imx424_front@1c {
			status = "disabled";
			compatible = "tcc-sony,imx424";
			reg = < 0x1c >;
		};

		imx424_rear@1d {
			status = "disabled";
			compatible = "tcc-sony,imx424";
			reg = < 0x1d >;
		};

		arxxxx@50 {
			status = "okay";
			compatible = "tcc-onnn,arxxxx";
			reg = < 0x50 >;

			port {

				endpoint {
					remote-endpoint = < 0x2b >;
					io-direction = "output";
					phandle = < 0x2c >;
				};
			};
		};

		ar0147@10 {
			status = "disabled";
			compatible = "tcc-onnn,ar0147";
			reg = < 0x10 >;
		};

		ar0820@10 {
			status = "disabled";
			compatible = "tcc-onnn,ar0820";
			reg = < 0x10 >;
		};

		ar0231@10 {
			status = "disabled";
			compatible = "tcc-onnn,ar0231";
			reg = < 0x10 >;
		};

		cxd5700@18 {
			status = "disabled";
			compatible = "tcc-sony,cxd5700";
			reg = < 0x18 >;
		};

		max96717@40 {
			status = "disabled";
			compatible = "tcc-maxim,max96717";
			reg = < 0x40 >;
		};

		max96701@40 {
			status = "okay";
			compatible = "tcc-maxim,max96701";
			reg = < 0x40 >;

			ports {
				#address-cells = < 0x01 >;
				#size-cells = < 0x00 >;

				port@0 {
					reg = < 0x00 >;

					endpoint {
						remote-endpoint = < 0x2c >;
						io-direction = "input";
						phandle = < 0x2b >;
					};
				};

				port@1 {
					reg = < 0x01 >;

					endpoint {
						remote-endpoint = < 0x2d >;
						io-direction = "output";
						phandle = < 0x2f >;
					};
				};
			};
		};

		max9275@40 {
			status = "disabled";
			compatible = "tcc-maxim,max9275";
			reg = < 0x40 >;
		};

		max9295@40 {
			status = "disabled";
			compatible = "tcc-maxim,max9295";
			reg = < 0x40 >;
		};

		max96705@40 {
			status = "disabled";
			compatible = "tcc-maxim,max96705";
			reg = < 0x40 >;
		};

		max9295e@42 {
			status = "disabled";
			compatible = "tcc-maxim,max9295";
			reg = < 0x42 >;
		};

		max9286@48 {
			status = "okay";
			compatible = "tcc-maxim,max9286";
			pwd-gpios = < 0x2e 0x05 0x01 >;
			reg = < 0x48 >;
			broadcasting-mode;

			ports {
				#address-cells = < 0x01 >;
				#size-cells = < 0x00 >;

				port@0 {
					reg = < 0x00 >;

					endpoint {
						remote-endpoint = < 0x2f >;
						io-direction = "input";
						channel = < 0x00 >;
						phandle = < 0x2d >;
					};
				};

				port@1 {
					reg = < 0x01 >;

					endpoint {
						remote-endpoint = < 0x2f >;
						io-direction = "input";
						channel = < 0x01 >;
					};
				};

				port@2 {
					reg = < 0x02 >;

					endpoint {
						remote-endpoint = < 0x2f >;
						io-direction = "input";
						channel = < 0x02 >;
					};
				};

				port@3 {
					reg = < 0x03 >;

					endpoint {
						remote-endpoint = < 0x2f >;
						io-direction = "input";
						channel = < 0x03 >;
					};
				};

				port@4 {
					reg = < 0x04 >;

					endpoint {
						remote-endpoint = < 0x30 >;
						io-direction = "output";
						channel = < 0x00 >;
						phandle = < 0x75 >;
					};
				};
			};
		};

		max96712@2a {
			status = "disabled";
			compatible = "tcc-maxim,max96712";
			pwd-gpios = < 0x2e 0x05 0x01 >;
			rst-gpios = < 0x31 0x11 0x01 >;
			reg = < 0x2a >;
		};
	};

	spi@16900000 {
		compatible = "telechips,tcc805x-spi";
		reg = < 0x00 0x16900000 0x00 0x38 0x00 0x16960000 0x00 0x20 0x00 0x16980000 0x00 0x20 >;
		interrupts = < 0x00 0x37 0x04 >;
		clocks = < 0x1e 0x14000768 0x15 0x73 >;
		resets = < 0x21 0x73 >;
		reset-names = "iobus-gpsb0";
		gpsb-id = < 0x00 >;
		status = "disabled";
	};

	spi@16910000 {
		compatible = "telechips,tcc805x-tsif";
		reg = < 0x00 0x16910000 0x00 0x38 0x00 0x16960000 0x00 0x20 0x00 0x16980020 0x00 0x20 >;
		interrupts = < 0x00 0x38 0x04 >;
		clocks = < 0x1e 0x1400076c 0x15 0x74 >;
		resets = < 0x21 0x74 >;
		reset-names = "iobus-gpsb1";
		gpsb-id = < 0x00 >;
		status = "disabled";
	};

	spi@16920000 {
		compatible = "telechips,tcc805x-tsif";
		reg = < 0x00 0x16920000 0x00 0x38 0x00 0x16960000 0x00 0x20 0x00 0x16980040 0x00 0x20 >;
		interrupts = < 0x00 0x39 0x04 >;
		clocks = < 0x1e 0x14000770 0x15 0x75 >;
		resets = < 0x21 0x75 >;
		reset-names = "iobus-gpsb2";
		gpsb-id = < 0x01 >;
		status = "disabled";
	};

	spi@16930000 {
		compatible = "telechips,tcc805x-spi";
		reg = < 0x00 0x16930000 0x00 0x38 0x00 0x16960000 0x00 0x20 >;
		interrupts = < 0x00 0x3a 0x04 >;
		clocks = < 0x1e 0x14000774 0x15 0x76 >;
		resets = < 0x21 0x76 >;
		reset-names = "iobus-gpsb3";
		gpsb-id = < 0x01 >;
		status = "disabled";
	};

	spi@16940000 {
		compatible = "telechips,tcc805x-spi";
		reg = < 0x00 0x16940000 0x00 0x38 0x00 0x16960000 0x00 0x20 >;
		interrupts = < 0x00 0x3b 0x04 >;
		clocks = < 0x1e 0x14000778 0x15 0x77 >;
		resets = < 0x21 0x77 >;
		reset-names = "iobus-gpsb4";
		gpsb-id = < 0x04 >;
		status = "disabled";
	};

	spi@16950000 {
		compatible = "telechips,tcc805x-spi";
		reg = < 0x00 0x16950000 0x00 0x38 0x00 0x16960000 0x00 0x20 >;
		interrupts = < 0x00 0x3c 0x04 >;
		clocks = < 0x1e 0x1400077c 0x15 0x78 >;
		resets = < 0x21 0x78 >;
		reset-names = "iobus-gpsb5";
		gpsb-id = < 0x05 >;
		status = "disabled";
	};

	tca53@14700000 {
		compatible = "telechips,tsens";
		init = "false";
		sc-firmware = < 0x13 >;
		reg = < 0x00 0x14700000 0x00 0x160 >;
		status = "okay";
		interrupts = < 0x00 0x28 0x04 >;
		core = < 0x00 >;
		threshold_high_temp = < 0x4b >;
		threshold_low_temp = < 0xffffffd8 >;
		interval_time = < 0x3ffff >;
		#thermal-sensor-cells = < 0x01 >;
		phandle = < 0x32 >;
	};

	gpu@14700000 {
		compatible = "telechips,tsens";
		init = "false";
		sc-firmware = < 0x13 >;
		reg = < 0x00 0x14700000 0x00 0x160 >;
		status = "okay";
		interrupts = < 0x00 0x28 0x04 >;
		core = < 0x05 >;
		threshold_high_temp = < 0x4b >;
		threshold_low_temp = < 0xffffffd8 >;
		interval_time = < 0x3ffff >;
		#thermal-sensor-cells = < 0x01 >;
		phandle = < 0x36 >;
	};

	thermal-zones {

		cpu-thermal {
			polling-delay = < 0x3e8 >;
			polling-delay-passive = < 0x3e8 >;
			thermal-sensors = < 0x32 0x00 >;

			trips {

				trip-point@0 {
					temperature = < 0x124f8 >;
					hysteresis = < 0x00 >;
					type = "passive";
					phandle = < 0x33 >;
				};

				trip-point@1 {
					temperature = < 0x13880 >;
					hysteresis = < 0x00 >;
					type = "passive";
					phandle = < 0x34 >;
				};

				trip-point@2 {
					temperature = < 0x14c08 >;
					hysteresis = < 0x00 >;
					type = "passive";
					phandle = < 0x35 >;
				};
			};

			cooling-maps {

				map0 {
					trip = < 0x33 >;
					cooling-device = < 0x05 0x00 0x01 >;
				};

				map1 {
					trip = < 0x34 >;
					cooling-device = < 0x05 0x01 0x02 >;
				};

				map2 {
					trip = < 0x35 >;
					cooling-device = < 0x05 0x02 0x03 >;
				};
			};
		};

		gpu-thermal {
			polling-delay = < 0x3e8 >;
			polling-delay-passive = < 0x3e8 >;
			thermal-sensors = < 0x36 0x05 >;

			trips {

				gpu-trip-point@0 {
					temperature = < 0x11170 >;
					hysteresis = < 0x00 >;
					type = "passive";
					phandle = < 0x37 >;
				};

				gpu-trip-point@1 {
					temperature = < 0x124f8 >;
					hysteresis = < 0x00 >;
					type = "passive";
					phandle = < 0x38 >;
				};

				gpu-trip-point@2 {
					temperature = < 0x13880 >;
					hysteresis = < 0x00 >;
					type = "passive";
					phandle = < 0x39 >;
				};
			};

			cooling-maps {

				map0 {
					trip = < 0x37 >;
					cooling-device = < 0x05 0x00 0x01 >;
				};

				map1 {
					trip = < 0x38 >;
					cooling-device = < 0x05 0x01 0x02 >;
				};

				map2 {
					trip = < 0x39 >;
					cooling-device = < 0x05 0x02 0x03 >;
				};
			};
		};
	};

	tcc_ipi_main {
		compatible = "telechips,mailbox-ipi-protocol";
		mboxes = < 0x3a 0x00 >;
		phandle = < 0x4a >;
	};

	tcc_ipi_micom {
		compatible = "telechips,mailbox-ipi-protocol";
		mboxes = < 0x3b 0x00 >;
		phandle = < 0x3d >;
	};

	tcc_ipi_hsm {
		compatible = "telechips,mailbox-ipi-protocol";
		mboxes = < 0x3c 0x00 >;
		phandle = < 0x46 >;
	};

	pmi {
		compatible = "telechips,pmi";
		tcc_ipi = < 0x3d >;
	};

	pwm_a {
		compatible = "telechips,pwm";
		reg = < 0x00 0x16030000 0x00 0x90 0x00 0x1605104c 0x00 0x04 0x00 0x16051094 0x00 0x04 >;
		tcc,pwm-number = < 0x01 >;
		#pwm-cells = < 0x02 >;
		pwm-num = < 0x00 >;
		clocks = < 0x1e 0x1400072c 0x15 0x4c >;
		clock-frequency = < 0x17d78400 >;
		gfb-port = < 0xff >;
		status = "disabled";
	};

	pwm_b {
		compatible = "telechips,pwm";
		reg = < 0x00 0x16030000 0x00 0x90 0x00 0x1605104c 0x00 0x04 0x00 0x16051094 0x00 0x04 >;
		tcc,pwm-number = < 0x01 >;
		#pwm-cells = < 0x02 >;
		pwm-num = < 0x01 >;
		clocks = < 0x1e 0x1400072c 0x15 0x4c >;
		clock-frequency = < 0x17d78400 >;
		gfb-port = < 0xff >;
		status = "disabled";
	};

	pwm_c {
		compatible = "telechips,pwm";
		reg = < 0x00 0x16030000 0x00 0x90 0x00 0x1605104c 0x00 0x04 0x00 0x16051094 0x00 0x04 >;
		tcc,pwm-number = < 0x01 >;
		#pwm-cells = < 0x02 >;
		pwm-num = < 0x02 >;
		clocks = < 0x1e 0x1400072c 0x15 0x4c >;
		clock-frequency = < 0x17d78400 >;
		gfb-port = < 0xff >;
		status = "disabled";
	};

	pwm_d {
		compatible = "telechips,pwm";
		reg = < 0x00 0x16030000 0x00 0x90 0x00 0x1605104c 0x00 0x04 0x00 0x16051094 0x00 0x04 >;
		tcc,pwm-number = < 0x01 >;
		#pwm-cells = < 0x02 >;
		pwm-num = < 0x03 >;
		clocks = < 0x1e 0x1400072c 0x15 0x4c >;
		clock-frequency = < 0x17d78400 >;
		gfb-port = < 0xff >;
		status = "disabled";
	};

	usb20host_vbus {
		compatible = "regulator-gpio";
		regulator-name = "vbus_supply_ehci";
		regulator-type = "voltage";
		regulator-min-microvolt = < 0x01 >;
		regulator-max-microvolt = < 0x4c4b40 >;
		gpios-states = < 0x00 >;
		states = < 0x01 0x00 0x4c4b40 0x01 >;
		status = "okay";
		gpios = < 0x3e 0x0f 0x00 >;
		phandle = < 0x3f >;
	};

	usb20host_phy@11DA0010 {
		compatible = "telechips,tcc_ehci_phy";
		reg = < 0x00 0x11da0010 0x00 0x30 >;
		interrupts = < 0x00 0x8f 0x04 >;
		vbus-supply = < 0x3f >;
		vbus-ctrl-able;
		status = "okay";
		phandle = < 0x40 >;
	};

	usb_ehci@11A00000 {
		compatible = "telechips,tcc-ehci";
		reg = < 0x00 0x11a00000 0x00 0x108 0x00 0x11da0010 0x00 0x54 >;
		interrupts = < 0x00 0x8e 0x04 >;
		telechips,ehci_phy = < 0x40 >;
		tpl-support;
		status = "okay";
	};

	usb_ohci@11A80000 {
		compatible = "telechips,tcc-ohci";
		reg = < 0x00 0x11a80000 0x00 0x60 0x00 0x11da0010 0x00 0x54 >;
		interrupts = < 0x00 0x8e 0x04 >;
		tpl-support;
		status = "okay";
	};

	usb20drd_vbus {
		compatible = "regulator-gpio";
		regulator-name = "vbus_supply_dwc2";
		regulator-type = "voltage";
		regulator-min-microvolt = < 0x01 >;
		regulator-max-microvolt = < 0x4c4b40 >;
		gpios-states = < 0x00 >;
		states = < 0x01 0x00 0x4c4b40 0x01 >;
		status = "disabled";
		phandle = < 0x41 >;
	};

	usb20drd_phy_host@11DA00DC {
		compatible = "telechips,tcc_ehci_phy";
		reg = < 0x00 0x11da00dc 0x00 0x20 >;
		interrupts = < 0x00 0x94 0x04 >;
		mux;
		status = "disabled";
		phandle = < 0x43 >;
	};

	usb20drd_phy_dev@11DA0100 {
		compatible = "telechips,tcc_dwc_otg_phy";
		reg = < 0x00 0x11da0100 0x00 0x30 >;
		vbus-supply = < 0x41 >;
		mux;
		status = "disabled";
		phandle = < 0x42 >;
	};

	usb_dwc2@11980000 {
		compatible = "telechips,dwc2";
		reg = < 0x00 0x11980000 0x00 0xcfff 0x00 0x11900000 0x00 0x108 0x00 0x11940000 0x00 0x60 >;
		interrupts = < 0x00 0x91 0x04 0x00 0x93 0x04 >;
		usb-phy = < 0x42 0x43 >;
		dr_mode = "host";
		status = "disabled";
	};

	usb30drd_vbus {
		compatible = "regulator-gpio";
		regulator-name = "vbus_supply_dwc3";
		regulator-type = "voltage";
		regulator-min-microvolt = < 0x01 >;
		regulator-max-microvolt = < 0x4c4b40 >;
		gpios-states = < 0x00 >;
		states = < 0x01 0x00 0x4c4b40 0x01 >;
		status = "disabled";
		phandle = < 0x44 >;
	};

	usb30drd_phy@11D90000 {
		compatible = "telechips,tcc_dwc3_phy";
		reg = < 0x00 0x11d90000 0x00 0x48 0x00 0x11da00ec 0x00 0x04 >;
		interrupts = < 0x00 0x9b 0x04 >;
		vbus-supply = < 0x44 >;
		vbus-ctrl-able;
		status = "disabled";
		phandle = < 0x45 >;
	};

	usb_dwc3@11B00000 {
		compatible = "telechips,tcc-dwc3";
		usb-phy = < 0x45 >;
		#address-cells = < 0x02 >;
		#size-cells = < 0x02 >;
		status = "disabled";
		ranges;
		reg = < 0x00 0x11b00000 0x00 0xcfff >;

		dwc3 {
			compatible = "snps,dwc3";
			reg = < 0x00 0x11b00000 0x00 0xcfff >;
			interrupts = < 0x00 0x98 0x04 >;
			usb-phy = < 0x45 >;
			usb-role-switch;
			role-switch-default-mode = "host";
		};
	};

	sec-ipc-hsm {
		compatible = "telechips,sec-ipc-hsm";
		mbox-names = "sec-ipc-hsm";
		mboxes = < 0x3c 0x00 >;
		mbox-id = "HSM";
		tcc_ipi = < 0x46 >;
	};

	tcc_hsm@0 {
		compatible = "telechips,tcc-hsm";
		status = "okay";
	};

	tcc_rng@0 {
		compatible = "telechips,tcc-rng";
		status = "okay";
	};

	firmware {

		optee {
			compatible = "linaro,optee-tz";
			method = "smc";
		};
	};

	ddi_config@12380000 {
		compatible = "telechips,ddi_config";
		reg = < 0x00 0x12380000 0x00 0x70 >;
	};

	cifport@12380008 {
		compatible = "telechips,cif-port";
		reg = < 0x00 0x12380008 0x00 0x04 >;
		phandle = < 0x7e >;
	};

	vioc_config@1200a000 {
		compatible = "telechips,vioc_config";
		reg = < 0x00 0x1200a000 0x00 0x1000 0x00 0x12046000 0x00 0x1000 >;
	};

	vioc_intr@1200a400 {
		compatible = "telechips,vioc_intr";
		reg = < 0x00 0x1200a400 0x00 0x100 0x00 0x12046400 0x00 0x100 >;
		interrupts = < 0x00 0x77 0x04 >;
	};

	vioc_disp@12000000 {
		compatible = "telechips,vioc_disp";
		reg = < 0x00 0x12000000 0x00 0x100 0x00 0x12000100 0x00 0x100 0x00 0x12000200 0x00 0x100 0x00 0x12000300 0x00 0x100 0x00 0x12000000 0x00 0x100 0x00 0x12001000 0x00 0x100 0x00 0x12002000 0x00 0x100 0x00 0x12003000 0x00 0x100 >;
		interrupts = < 0x00 0x77 0x04 0x00 0x77 0x04 0x00 0x77 0x04 0x00 0x77 0x04 >;
		clocks = < 0x47 0x120 0x1e 0x14000504 0x1e 0x14000508 0x1e 0x1400050c 0x1e 0x14000518 >;
		clock-names = "ddi-clk\0disp0-clk\0disp1-clk\0disp2-clk\0disp3-clk";
		phandle = < 0x4b >;
	};

	vioc_rdma@12000400 {
		compatible = "telechips,vioc_rdma";
		reg = < 0x00 0x12000400 0x00 0x100 0x00 0x12000500 0x00 0x100 0x00 0x12000600 0x00 0x100 0x00 0x12000700 0x00 0x100 0x00 0x12000800 0x00 0x100 0x00 0x12000900 0x00 0x100 0x00 0x12000a00 0x00 0x100 0x00 0x12000b00 0x00 0x100 0x00 0x12000c00 0x00 0x100 0x00 0x12000d00 0x00 0x100 0x00 0x12000e00 0x00 0x100 0x00 0x12000f00 0x00 0x100 0x00 0x12001000 0x00 0x100 0x00 0x12001100 0x00 0x100 0x00 0x12001200 0x00 0x100 0x00 0x12001300 0x00 0x100 0x00 0x12001400 0x00 0x100 0x00 0x12001500 0x00 0x100 0x00 0x12004000 0x00 0x100 0x00 0x12005000 0x00 0x100 0x00 0x12006000 0x00 0x100 0x00 0x12007000 0x00 0x100 0x00 0x12008000 0x00 0x100 0x00 0x12009000 0x00 0x100 0x00 0x1200a000 0x00 0x100 0x00 0x1200b000 0x00 0x100 0x00 0x1200c000 0x00 0x100 0x00 0x1200d000 0x00 0x100 0x00 0x1200e000 0x00 0x100 0x00 0x1200f000 0x00 0x100 0x00 0x12010000 0x00 0x100 0x00 0x12011000 0x00 0x100 0x00 0x12012000 0x00 0x100 0x00 0x12013000 0x00 0x100 0x00 0x12014000 0x00 0x100 0x00 0x12015000 0x00 0x100 >;
		interrupts = < 0x00 0x77 0x04 0x00 0x77 0x04 0x00 0x77 0x04 0x00 0x77 0x04 0x00 0x77 0x04 0x00 0x77 0x04 0x00 0x77 0x04 0x00 0x77 0x04 0x00 0x77 0x04 0x00 0x77 0x04 0x00 0x77 0x04 0x00 0x77 0x04 0x00 0x77 0x04 0x00 0x77 0x04 0x00 0x77 0x04 0x00 0x77 0x04 0x00 0x77 0x04 0x00 0x77 0x04 >;
		phandle = < 0x48 >;
	};

	vioc_wmix@12001800 {
		compatible = "telechips,vioc_wmix";
		reg = < 0x00 0x12001800 0x00 0x100 0x00 0x12001900 0x00 0x100 0x00 0x12001a00 0x00 0x100 0x00 0x12001b00 0x00 0x100 0x00 0x12001c00 0x00 0x100 0x00 0x12001d00 0x00 0x100 0x00 0x12001e00 0x00 0x100 0x00 0x12018000 0x00 0x100 0x00 0x12019000 0x00 0x100 0x00 0x1201a000 0x00 0x100 0x00 0x1201b000 0x00 0x100 0x00 0x1201c000 0x00 0x100 0x00 0x1201d000 0x00 0x100 0x00 0x1201e000 0x00 0x100 >;
		interrupts = < 0x00 0x77 0x04 0x00 0x77 0x04 0x00 0x77 0x04 0x00 0x77 0x04 0x00 0x77 0x04 0x00 0x77 0x04 0x00 0x77 0x04 >;
		phandle = < 0x49 >;
	};

	vioc_scaler@12002000 {
		compatible = "telechips,scaler";
		reg = < 0x00 0x12002000 0x00 0x100 0x00 0x12002100 0x00 0x100 0x00 0x12002200 0x00 0x100 0x00 0x12002300 0x00 0x100 0x00 0x12002400 0x00 0x100 0x00 0x12002500 0x00 0x100 0x00 0x12002600 0x00 0x100 0x00 0x12002700 0x00 0x100 0x00 0x12020000 0x00 0x100 0x00 0x12021000 0x00 0x100 0x00 0x12022000 0x00 0x100 0x00 0x12023000 0x00 0x100 0x00 0x12024000 0x00 0x100 0x00 0x12025000 0x00 0x100 0x00 0x12026000 0x00 0x100 0x00 0x12027000 0x00 0x100 >;
		phandle = < 0x4e >;
	};

	vioc_wdma@12002800 {
		compatible = "telechips,vioc_wdma";
		reg = < 0x00 0x12002800 0x00 0x100 0x00 0x12002900 0x00 0x100 0x00 0x12002a00 0x00 0x100 0x00 0x12002b00 0x00 0x100 0x00 0x12002c00 0x00 0x100 0x00 0x12002d00 0x00 0x100 0x00 0x12002e00 0x00 0x100 0x00 0x12002f00 0x00 0x100 0x00 0x12003000 0x00 0x100 0x00 0x12014000 0x00 0x100 0x00 0x12014100 0x00 0x100 0x00 0x12014200 0x00 0x100 0x00 0x12014300 0x00 0x100 0x00 0x12014400 0x00 0x100 0x00 0x12028000 0x00 0x100 0x00 0x12029000 0x00 0x100 0x00 0x1202a000 0x00 0x100 0x00 0x1202b000 0x00 0x100 0x00 0x1202c000 0x00 0x100 0x00 0x1202d000 0x00 0x100 0x00 0x1202e000 0x00 0x100 0x00 0x1202f000 0x00 0x100 0x00 0x12030000 0x00 0x100 0x00 0x12052000 0x00 0x100 0x00 0x12053000 0x00 0x100 0x00 0x12054000 0x00 0x100 0x00 0x12059000 0x00 0x100 0x00 0x1205a000 0x00 0x100 >;
		interrupts = < 0x00 0x77 0x04 0x00 0x77 0x04 0x00 0x77 0x04 0x00 0x77 0x04 0x00 0x77 0x04 0x00 0x77 0x04 0x00 0x77 0x04 0x00 0x77 0x04 0x00 0x77 0x04 0x00 0x77 0x04 0x00 0x77 0x04 0x00 0x77 0x04 0x00 0x77 0x04 0x00 0x77 0x04 >;
		phandle = < 0x4c >;
	};

	vioc_vin@12004000 {
		compatible = "telechips,vioc_vin";
		reg = < 0x00 0x12004000 0x00 0x400 0x00 0x12004400 0x00 0x600 0x00 0x12005000 0x00 0x400 0x00 0x12005400 0x00 0x600 0x00 0x12006000 0x00 0x400 0x00 0x12006400 0x00 0x600 0x00 0x12007000 0x00 0x400 0x00 0x12007400 0x00 0x600 0x00 0x12018000 0x00 0x400 0x00 0x12018400 0x00 0x600 0x00 0x12019000 0x00 0x400 0x00 0x12019400 0x00 0x600 0x00 0x1201a000 0x00 0x400 0x00 0x1201a400 0x00 0x600 0x00 0x1201b000 0x00 0x400 0x00 0x1201b400 0x00 0x600 0x00 0x12040000 0x00 0x400 0x00 0x12040400 0x00 0x600 0x00 0x12041000 0x00 0x400 0x00 0x12041400 0x00 0x600 0x00 0x12042000 0x00 0x400 0x00 0x12042400 0x00 0x600 0x00 0x12043000 0x00 0x400 0x00 0x12043400 0x00 0x600 0x00 0x12055000 0x00 0x400 0x00 0x12055400 0x00 0x600 0x00 0x12056000 0x00 0x400 0x00 0x12056400 0x00 0x600 0x00 0x12057000 0x00 0x400 0x00 0x12057400 0x00 0x600 0x00 0x12058000 0x00 0x400 0x00 0x12058400 0x00 0x600 >;
		interrupts = < 0x00 0x77 0x04 0x00 0x77 0x04 0x00 0x77 0x04 0x00 0x77 0x04 0x00 0x77 0x04 0x00 0x77 0x04 0x00 0x77 0x04 0x00 0x77 0x04 0x00 0x77 0x04 0x00 0x77 0x04 0x00 0x77 0x04 0x00 0x77 0x04 0x00 0x77 0x04 0x00 0x77 0x04 0x00 0x77 0x04 0x00 0x77 0x04 >;
		phandle = < 0x7a >;
	};

	vioc_viqe@1200d000 {
		compatible = "telechips,vioc_viqe";
		reg = < 0x00 0x1200d000 0x00 0x1000 0x00 0x12010000 0x00 0x1000 0x00 0x1204b000 0x00 0x1000 0x00 0x1204e000 0x00 0x1000 >;
		phandle = < 0x4d >;
	};

	vioc_lut@12009000 {
		compatible = "telechips,vioc_lut";
		reg = < 0x00 0x12009000 0x00 0x800 0x00 0x12045000 0x00 0x800 >;
	};

	vioc_lut_3d@12003200 {
		compatible = "telechips,vioc_lut_3d";
		reg = < 0x00 0x12003200 0x00 0x200 0x00 0x12003400 0x00 0x200 0x00 0x12032000 0x00 0x2000 0x00 0x12034000 0x00 0x2000 >;
	};

	vioc_deintls@12003800 {
		compatible = "telechips,vioc_deintls";
		reg = < 0x00 0x12003800 0x00 0x100 0x00 0x12038000 0x00 0x100 >;
		phandle = < 0x7b >;
	};

	vioc_fifo@12003b00 {
		compatible = "telechips,vioc_fifo";
		reg = < 0x00 0x12003b00 0x00 0x100 0x00 0x1203b000 0x00 0x100 >;
		phandle = < 0x7c >;
	};

	vioc_rdma_arbitor@12003f00 {
		reg = < 0x00 0x12003f00 0x00 0x20 0x00 0x12003f20 0x00 0x20 0x00 0x12003f40 0x00 0x20 0x00 0x12003f60 0x00 0x20 0x00 0x1203f000 0x00 0x20 0x00 0x1203f020 0x00 0x20 0x00 0x1203f040 0x00 0x20 0x00 0x1203f060 0x00 0x20 >;
		arbitor_num = < 0x04 >;
	};

	vioc_mc@12001600 {
		compatible = "telechips,vioc_mc";
		reg = < 0x00 0x12001600 0x00 0x100 0x00 0x12001700 0x00 0x100 0x00 0x12016000 0x00 0x100 0x00 0x12017000 0x00 0x100 >;
		phandle = < 0x4f >;
	};

	vioc_pvric_fbdc@12012000 {
		compatible = "telechips,vioc_pvric_fbdc";
		reg = < 0x00 0x12012000 0x00 0x100 0x00 0x12013000 0x00 0x100 0x00 0x12050000 0x00 0x100 0x00 0x12051000 0x00 0x100 >;
		phandle = < 0x70 >;
	};

	vioc_api {
		compatible = "telechips,vioc_api";
		status = "okay";
	};

	tccmisc {
		compatible = "telechips,tccmisc";
		status = "okay";
	};

	tcc_scrshare0 {
		compatible = "telechips,tcc_scrshare";
		device-name = "tcc_scrshare_sub";
		rdma = < 0x48 0x209 >;
		wmix = < 0x49 0x402 >;
		tcc-ipi = < 0x4a >;
		status = "disabled";
	};

	vout_drv@0 {
		compatible = "telechips,v4l2_vout";
		clocks = < 0x47 0x120 >;
		status = "okay";
		rdma = < 0x48 0x203 >;
		wmix = < 0x49 0x400 >;
		disp = < 0x4b 0x100 >;
		subplane_rdma = < 0x48 0x202 >;
		m2m_subplane_rdma = < 0x48 0x20c >;
		m2m_rdma = < 0x48 0x20d >;
		m2m_wmix = < 0x49 0x403 >;
		m2m_wdma = < 0x4c 0x703 >;
		rdma_bootani = < 0x48 0x207 >;
		wmix_bootani = < 0x49 0x401 >;
		disp_bootani = < 0x4b 0x101 >;
		deintl_block = < 0x4d 0x1000 >;
		scaler = < 0x4e 0x501 >;
		mc = < 0x4f 0x301 >;
	};

	tcc_overlay_drv {
		compatible = "telechips,tcc_overlay";
		clocks = < 0x47 0x120 >;
		status = "okay";
		rdmas = < 0x48 0x200 0x201 0x202 0x203 0x204 0x205 0x206 0x207 0x208 0x209 0x20a 0x20b >;
		wmixs = < 0x49 0x400 0x401 0x402 >;
		scalers = < 0x4e 0x507 >;
		mc = < 0x4f 0xffff >;
		display_num = < 0x00 >;
		rdma_init_layer = < 0x01 >;
	};

	tcc_overlay_drv@1 {
		compatible = "telechips,tcc_overlay";
		clocks = < 0x47 0x120 >;
		status = "disabled";
		rdmas = < 0x48 0x200 0x201 0x202 0x203 0x204 0x205 0x206 0x207 0x208 0x209 0x20a 0x20b >;
		wmixs = < 0x49 0x400 0x401 0x402 >;
		scalers = < 0x4e 0xffff >;
		mc = < 0x4f 0xffff >;
		display_num = < 0x01 >;
		rdma_init_layer = < 0x02 >;
	};

	lcd_port1_bl {
		compatible = "gpio-backlight";
		status = "disabled";
		gpios = < 0x50 0x06 0x00 >;
	};

	lcd_port2_bl {
		compatible = "gpio-backlight";
		status = "disabled";
		gpios = < 0x50 0x07 0x00 >;
	};

	lcd_port3_bl {
		compatible = "gpio-backlight";
		status = "okay";
		gpios = < 0x51 0x1d 0x00 >;
		phandle = < 0x62 >;
	};

	lcd_port4_bl {
		compatible = "gpio-backlight";
		status = "disabled";
		gpios = < 0x24 0x15 0x00 >;
	};

	panel_dp@0 {
		compatible = "telechips,drm-lvds-dpv14-0";
		status = "disabled";
		pinctrl-names = "default\0sleep\0power_on\0reset_off\0blk_on\0blk_off\0power_off";
		pinctrl-0;
		pinctrl-1;
		pinctrl-2;
		pinctrl-3;
		pinctrl-4;
		pinctrl-5;
		pinctrl-6;
		backlight;
		blk-wait-time = < 0x104 >;

		display-timings {
			native-mode = < 0x52 >;

			1920x720p60@0 {
				clock-frequency = < 0x541d340 >;
				hactive = < 0x780 >;
				vactive = < 0x2d0 >;
				hfront-porch = < 0x1e >;
				hback-porch = < 0x1e >;
				hsync-len = < 0x04 >;
				hsync-active = < 0x00 >;
				vback-porch = < 0x09 >;
				vfront-porch = < 0x0a >;
				vsync-len = < 0x02 >;
				vsync-active = < 0x00 >;
				de-active = < 0x01 >;
				pixelclk-active = < 0x01 >;
			};

			1920x720p60@1 {
				clock-frequency = < 0x677e240 >;
				hactive = < 0x780 >;
				vactive = < 0x2d0 >;
				hfront-porch = < 0x164 >;
				hback-porch = < 0x60 >;
				hsync-len = < 0x08 >;
				hsync-active = < 0x00 >;
				vback-porch = < 0x03 >;
				vfront-porch = < 0x24 >;
				vsync-len = < 0x01 >;
				vsync-active = < 0x00 >;
				de-active = < 0x01 >;
				pixelclk-active = < 0x01 >;
				phandle = < 0x52 >;
			};
		};

		ports {
			#address-cells = < 0x01 >;
			#size-cells = < 0x00 >;

			port@0 {
				#address-cells = < 0x01 >;
				#size-cells = < 0x00 >;
				reg = < 0x00 >;

				endpoint@0 {
					reg = < 0x00 >;
				};
			};
		};
	};

	panel_dp@1 {
		compatible = "telechips,drm-lvds-dpv14-1";
		status = "disabled";
		pinctrl-names = "default\0sleep\0power_on\0reset_off\0blk_on\0blk_off\0power_off";
		pinctrl-0;
		pinctrl-1;
		pinctrl-2;
		pinctrl-3;
		pinctrl-4;
		pinctrl-5;
		pinctrl-6;
		backlight;
		blk-wait-time = < 0x104 >;

		display-timings {
			native-mode = < 0x53 >;

			1920x720p60@0 {
				clock-frequency = < 0x541d340 >;
				hactive = < 0x780 >;
				vactive = < 0x2d0 >;
				hfront-porch = < 0x1e >;
				hback-porch = < 0x1e >;
				hsync-len = < 0x04 >;
				hsync-active = < 0x00 >;
				vback-porch = < 0x09 >;
				vfront-porch = < 0x0a >;
				vsync-len = < 0x02 >;
				vsync-active = < 0x00 >;
				de-active = < 0x01 >;
				pixelclk-active = < 0x01 >;
			};

			1920x720p60@1 {
				clock-frequency = < 0x677e240 >;
				hactive = < 0x780 >;
				vactive = < 0x2d0 >;
				hfront-porch = < 0x164 >;
				hback-porch = < 0x60 >;
				hsync-len = < 0x08 >;
				hsync-active = < 0x00 >;
				vback-porch = < 0x03 >;
				vfront-porch = < 0x24 >;
				vsync-len = < 0x01 >;
				vsync-active = < 0x00 >;
				de-active = < 0x01 >;
				pixelclk-active = < 0x01 >;
				phandle = < 0x53 >;
			};
		};

		ports {
			#address-cells = < 0x01 >;
			#size-cells = < 0x00 >;

			port@0 {
				#address-cells = < 0x01 >;
				#size-cells = < 0x00 >;
				reg = < 0x00 >;

				endpoint@0 {
					reg = < 0x00 >;
				};
			};
		};
	};

	panel_dp@2 {
		compatible = "telechips,drm-lvds-dpv14-2";
		status = "disabled";
		pinctrl-names = "default\0sleep\0power_on\0reset_off\0blk_on\0blk_off\0power_off";
		pinctrl-0;
		pinctrl-1;
		pinctrl-2;
		pinctrl-3;
		pinctrl-4;
		pinctrl-5;
		pinctrl-6;
		backlight;
		blk-wait-time = < 0x104 >;

		display-timings {
			native-mode = < 0x54 >;

			1920x720p60@0 {
				clock-frequency = < 0x541d340 >;
				hactive = < 0x780 >;
				vactive = < 0x2d0 >;
				hfront-porch = < 0x1e >;
				hback-porch = < 0x1e >;
				hsync-len = < 0x04 >;
				hsync-active = < 0x00 >;
				vback-porch = < 0x09 >;
				vfront-porch = < 0x0a >;
				vsync-len = < 0x02 >;
				vsync-active = < 0x00 >;
				de-active = < 0x01 >;
				pixelclk-active = < 0x01 >;
			};

			1920x720p60@1 {
				clock-frequency = < 0x677e240 >;
				hactive = < 0x780 >;
				vactive = < 0x2d0 >;
				hfront-porch = < 0x164 >;
				hback-porch = < 0x60 >;
				hsync-len = < 0x08 >;
				hsync-active = < 0x00 >;
				vback-porch = < 0x03 >;
				vfront-porch = < 0x24 >;
				vsync-len = < 0x01 >;
				vsync-active = < 0x00 >;
				de-active = < 0x01 >;
				pixelclk-active = < 0x01 >;
				phandle = < 0x54 >;
			};
		};

		ports {
			#address-cells = < 0x01 >;
			#size-cells = < 0x00 >;

			port@0 {
				#address-cells = < 0x01 >;
				#size-cells = < 0x00 >;
				reg = < 0x00 >;

				endpoint@0 {
					reg = < 0x00 >;
				};
			};
		};
	};

	panel_dp@3 {
		compatible = "telechips,drm-lvds-dpv14-3";
		status = "disabled";
		pinctrl-names = "default\0sleep\0power_on\0reset_off\0blk_on\0blk_off\0power_off";
		pinctrl-0;
		pinctrl-1;
		pinctrl-2;
		pinctrl-3;
		pinctrl-4;
		pinctrl-5;
		pinctrl-6;
		backlight;
		blk-wait-time = < 0x104 >;

		display-timings {
			native-mode = < 0x55 >;

			1920x720p60@0 {
				clock-frequency = < 0x541d340 >;
				hactive = < 0x780 >;
				vactive = < 0x2d0 >;
				hfront-porch = < 0x1e >;
				hback-porch = < 0x1e >;
				hsync-len = < 0x04 >;
				hsync-active = < 0x00 >;
				vback-porch = < 0x09 >;
				vfront-porch = < 0x0a >;
				vsync-len = < 0x02 >;
				vsync-active = < 0x00 >;
				de-active = < 0x01 >;
				pixelclk-active = < 0x01 >;
			};

			1920x720p60@1 {
				clock-frequency = < 0x677e240 >;
				hactive = < 0x780 >;
				vactive = < 0x2d0 >;
				hfront-porch = < 0x164 >;
				hback-porch = < 0x60 >;
				hsync-len = < 0x08 >;
				hsync-active = < 0x00 >;
				vback-porch = < 0x03 >;
				vfront-porch = < 0x24 >;
				vsync-len = < 0x01 >;
				vsync-active = < 0x00 >;
				de-active = < 0x01 >;
				pixelclk-active = < 0x01 >;
				phandle = < 0x55 >;
			};
		};

		ports {
			#address-cells = < 0x01 >;
			#size-cells = < 0x00 >;

			port@0 {
				#address-cells = < 0x01 >;
				#size-cells = < 0x00 >;
				reg = < 0x00 >;

				endpoint@0 {
					reg = < 0x00 >;
				};
			};
		};
	};

	panel_tm123xdhp90 {
		compatible = "telechips,drm-lvds-tm123xdhp90";
		status = "disabled";
		pinctrl-names = "default\0sleep\0pwr_on_1\0pwr_on_2\0blk_on\0blk_off\0power_off";
		pinctrl-0;
		pinctrl-1;
		pinctrl-2;
		pinctrl-3;
		pinctrl-4;
		pinctrl-5;
		pinctrl-6;
		backlight;

		display-timings {
			native-mode = < 0x56 >;

			1920x720p60 {
				clock-frequency = < 0x541d340 >;
				hactive = < 0x780 >;
				vactive = < 0x2d0 >;
				hfront-porch = < 0x1e >;
				hback-porch = < 0x1e >;
				hsync-len = < 0x04 >;
				hsync-active = < 0x00 >;
				vback-porch = < 0x09 >;
				vfront-porch = < 0x0a >;
				vsync-len = < 0x02 >;
				vsync-active = < 0x00 >;
				de-active = < 0x01 >;
				pixelclk-active = < 0x01 >;
				phandle = < 0x56 >;
			};
		};

		ports {
			#address-cells = < 0x01 >;
			#size-cells = < 0x00 >;

			port@0 {
				#address-cells = < 0x01 >;
				#size-cells = < 0x00 >;
				reg = < 0x00 >;

				endpoint@0 {
					reg = < 0x00 >;
				};
			};
		};
	};

	panel_auoc123han06 {
		compatible = "telechips,drm-lvds-auoc123han06";
		status = "disabled";
		blk-wait-time = < 0x104 >;
		pinctrl-names = "default\0sleep\0pwr_on_1\0pwr_on_2\0blk_on\0blk_off\0power_off";
		pinctrl-0;
		pinctrl-1;
		pinctrl-2;
		pinctrl-3;
		pinctrl-4;
		pinctrl-5;
		pinctrl-6;
		backlight;

		display-timings {
			native-mode = < 0x57 >;

			1920x720p60 {
				clock-frequency = < 0x677e240 >;
				hactive = < 0x780 >;
				vactive = < 0x2d0 >;
				hfront-porch = < 0x164 >;
				hback-porch = < 0x60 >;
				hsync-len = < 0x08 >;
				hsync-active = < 0x00 >;
				vback-porch = < 0x03 >;
				vfront-porch = < 0x24 >;
				vsync-len = < 0x01 >;
				vsync-active = < 0x00 >;
				de-active = < 0x01 >;
				pixelclk-active = < 0x01 >;
				phandle = < 0x57 >;
			};
		};

		ports {
			#address-cells = < 0x01 >;
			#size-cells = < 0x00 >;

			port@0 {
				#address-cells = < 0x01 >;
				#size-cells = < 0x00 >;
				reg = < 0x00 >;

				endpoint@0 {
					reg = < 0x00 >;
				};
			};
		};
	};

	panel_fld0800 {
		compatible = "telechips,drm-lvds-fld0800";
		status = "disabled";
		pinctrl-names = "default\0sleep\0pwr_on_1\0pwr_on_2\0blk_on\0blk_off\0power_off";
		pinctrl-0;
		pinctrl-1;
		pinctrl-2;
		pinctrl-3;
		pinctrl-4;
		pinctrl-5;
		pinctrl-6;
		backlight;

		display-timings {
			native-mode = < 0x58 >;

			1024x600p60 {
				clock-frequency = < 0x30d4000 >;
				hactive = < 0x400 >;
				vactive = < 0x258 >;
				hfront-porch = < 0x93 >;
				hback-porch = < 0x93 >;
				hsync-len = < 0x13 >;
				hsync-active = < 0x00 >;
				vback-porch = < 0x0a >;
				vfront-porch = < 0x19 >;
				vsync-len = < 0x02 >;
				vsync-active = < 0x00 >;
				de-active = < 0x01 >;
				pixelclk-active = < 0x01 >;
				phandle = < 0x58 >;
			};
		};

		ports {
			#address-cells = < 0x01 >;
			#size-cells = < 0x00 >;

			port@0 {
				#address-cells = < 0x01 >;
				#size-cells = < 0x00 >;
				reg = < 0x00 >;

				endpoint@0 {
					reg = < 0x00 >;
				};
			};
		};
	};

	fb_tm123xdhp90 {
		compatible = "telechips,fb-lvds-tm123xdhp90";
		status = "disabled";
		lvds0 = < 0x59 >;
		mode = < 0x00 >;
		phy-ports = < 0x02 0x03 >;
		data-mapping = "vesa-24";
		lane-main = < 0x04 0x00 0x03 0x02 0x01 >;
		lane-sub = < 0x01 0x02 0x03 0x00 0x04 >;
		vcm = < 0x4b0 >;
		vsw = < 0x1f4 >;
		lcdc-mux-select = < 0x02 >;
		lcdc-mux-bypass = "true";
		pinctrl-names = "default\0pwr_on_1\0pwr_on_2\0blk_on\0blk_off\0power_off";
		pinctrl-0;
		pinctrl-1;
		pinctrl-2;
		pinctrl-3;
		pinctrl-4;
		pinctrl-5;
		backlight;

		display-timings {
			native-mode = < 0x5a >;

			1920x720p60 {
				clock-frequency = < 0x541d340 >;
				hactive = < 0x780 >;
				vactive = < 0x2d0 >;
				hfront-porch = < 0x1c >;
				hback-porch = < 0x1c >;
				hsync-len = < 0x08 >;
				hsync-active = < 0x00 >;
				vback-porch = < 0x0a >;
				vfront-porch = < 0x0a >;
				vsync-len = < 0x02 >;
				vsync-active = < 0x00 >;
				de-active = < 0x01 >;
				pixelclk-active = < 0x01 >;
				phandle = < 0x5a >;
			};
		};

		ports {
			#address-cells = < 0x01 >;
			#size-cells = < 0x00 >;

			port@0 {
				#address-cells = < 0x01 >;
				#size-cells = < 0x00 >;
				reg = < 0x00 >;

				endpoint {
				};
			};
		};
	};

	fb_auoc123han06 {
		compatible = "telechips,fb-lvds-auoc123han06";
		status = "okay";
		blk-wait-time = < 0x104 >;
		lvds0 = < 0x59 >;
		mode = < 0x00 >;
		phy-ports = < 0x02 0x03 >;
		data-mapping = "vesa-24";
		lane-main = < 0x04 0x00 0x03 0x02 0x01 >;
		lane-sub = < 0x01 0x02 0x03 0x00 0x04 >;
		vcm = < 0x4b0 >;
		vsw = < 0x1f4 >;
		lcdc-mux-select = < 0x02 >;
		lcdc-mux-bypass = "true";
		pinctrl-names = "default\0pwr_on_1\0pwr_on_2\0blk_on\0blk_off\0power_off";
		pinctrl-0 = < 0x5b >;
		pinctrl-1 = < 0x5c >;
		pinctrl-2 = < 0x5d >;
		pinctrl-3 = < 0x5e >;
		pinctrl-4 = < 0x5f >;
		pinctrl-5 = < 0x60 0x61 >;
		backlight = < 0x62 >;

		display-timings {
			native-mode = < 0x63 >;

			1920x720p60 {
				clock-frequency = < 0x677e240 >;
				hactive = < 0x780 >;
				vactive = < 0x2d0 >;
				hfront-porch = < 0x164 >;
				hback-porch = < 0x60 >;
				hsync-len = < 0x08 >;
				hsync-active = < 0x00 >;
				vback-porch = < 0x03 >;
				vfront-porch = < 0x24 >;
				vsync-len = < 0x01 >;
				vsync-active = < 0x00 >;
				de-active = < 0x01 >;
				pixelclk-active = < 0x01 >;
				phandle = < 0x63 >;
			};
		};

		ports {
			#address-cells = < 0x01 >;
			#size-cells = < 0x00 >;

			port@0 {
				#address-cells = < 0x01 >;
				#size-cells = < 0x00 >;
				reg = < 0x00 >;

				endpoint {
					remote-endpoint = < 0x64 >;
					phandle = < 0x71 >;
				};
			};
		};
	};

	tcc-drm-lcd {
		compatible = "telechips,drm-vioc-0";
		status = "disabled";
		display_device = < 0x4b 0x100 >;
		lcdc-mux-select = < 0x03 >;
		lcdc-mux-bypass = < 0x01 >;
		wmixer = < 0x49 0x400 >;
		rdma = < 0x48 0x200 >;
		planes = "primary";
		clocks = < 0x47 0x120 0x1e 0x14000504 >;

		ports {
			#address-cells = < 0x01 >;
			#size-cells = < 0x00 >;

			port@0 {
				#address-cells = < 0x01 >;
				#size-cells = < 0x00 >;
			};
		};
	};

	tcc-drm-ext {
		compatible = "telechips,drm-vioc-1";
		status = "disabled";
		display_device = < 0x4b 0x101 >;
		lcdc-mux-select = < 0x00 >;
		lcdc-mux-bypass = < 0x00 >;
		wmixer = < 0x49 0x401 >;
		rdma = < 0x48 0x204 >;
		planes = "primary";
		clocks = < 0x47 0x120 0x1e 0x14000508 >;

		ports {
			#address-cells = < 0x01 >;
			#size-cells = < 0x00 >;

			port@0 {
				#address-cells = < 0x01 >;
				#size-cells = < 0x00 >;
			};
		};
	};

	tcc-drm-third {
		compatible = "telechips,drm-vioc-2";
		status = "disabled";
		display_device = < 0x4b 0x102 >;
		lcdc-mux-select = < 0x02 >;
		lcdc-mux-bypass = < 0x01 >;
		wmixer = < 0x49 0x402 >;
		rdma = < 0x48 0x208 >;
		planes = "primary";
		clocks = < 0x47 0x120 0x1e 0x1400050c >;

		ports {
			#address-cells = < 0x01 >;
			#size-cells = < 0x00 >;

			port@0 {
				#address-cells = < 0x01 >;
				#size-cells = < 0x00 >;
			};
		};
	};

	tcc-drm-fourth {
		compatible = "telechips,drm-vioc-3";
		status = "disabled";
		display_device = < 0x4b 0x103 >;
		lcdc-mux-select = < 0x01 >;
		lcdc-mux-bypass = < 0x00 >;
		wmixer = < 0x49 0x403 >;
		rdma = < 0x48 0x20c >;
		planes = "primary";
		clocks = < 0x47 0x120 0x1e 0x14000518 >;

		ports {
			#address-cells = < 0x01 >;
			#size-cells = < 0x00 >;

			port@0 {
				#address-cells = < 0x01 >;
				#size-cells = < 0x00 >;
			};
		};
	};

	drm_dp@0 {
		compatible = "telechips,drm-dp";
		status = "disabled";

		display-timings {
			native-mode = < 0x65 >;

			1920x720p60@0 {
				clock-frequency = < 0x541d340 >;
				hactive = < 0x780 >;
				vactive = < 0x2d0 >;
				hfront-porch = < 0x1e >;
				hback-porch = < 0x1e >;
				hsync-len = < 0x04 >;
				hsync-active = < 0x00 >;
				vback-porch = < 0x09 >;
				vfront-porch = < 0x0a >;
				vsync-len = < 0x02 >;
				vsync-active = < 0x00 >;
				de-active = < 0x01 >;
				pixelclk-active = < 0x01 >;
			};

			1920x720p60@1 {
				clock-frequency = < 0x677e240 >;
				hactive = < 0x780 >;
				vactive = < 0x2d0 >;
				hfront-porch = < 0x164 >;
				hback-porch = < 0x60 >;
				hsync-len = < 0x08 >;
				hsync-active = < 0x00 >;
				vback-porch = < 0x03 >;
				vfront-porch = < 0x24 >;
				vsync-len = < 0x01 >;
				vsync-active = < 0x00 >;
				de-active = < 0x01 >;
				pixelclk-active = < 0x01 >;
				phandle = < 0x65 >;
			};
		};

		ports {
			#address-cells = < 0x01 >;
			#size-cells = < 0x00 >;

			port@0 {
				#address-cells = < 0x01 >;
				#size-cells = < 0x00 >;
				reg = < 0x00 >;
			};

			port@1 {
				#address-cells = < 0x01 >;
				#size-cells = < 0x00 >;
				reg = < 0x01 >;

				endpoint@0 {
					reg = < 0x00 >;
				};
			};
		};
	};

	drm_dp@1 {
		compatible = "telechips,drm-dp";
		status = "disabled";

		display-timings {
			native-mode = < 0x66 >;

			1920x720p60@0 {
				clock-frequency = < 0x541d340 >;
				hactive = < 0x780 >;
				vactive = < 0x2d0 >;
				hfront-porch = < 0x1e >;
				hback-porch = < 0x1e >;
				hsync-len = < 0x04 >;
				hsync-active = < 0x00 >;
				vback-porch = < 0x09 >;
				vfront-porch = < 0x0a >;
				vsync-len = < 0x02 >;
				vsync-active = < 0x00 >;
				de-active = < 0x01 >;
				pixelclk-active = < 0x01 >;
			};

			1920x720p60@1 {
				clock-frequency = < 0x677e240 >;
				hactive = < 0x780 >;
				vactive = < 0x2d0 >;
				hfront-porch = < 0x164 >;
				hback-porch = < 0x60 >;
				hsync-len = < 0x08 >;
				hsync-active = < 0x00 >;
				vback-porch = < 0x03 >;
				vfront-porch = < 0x24 >;
				vsync-len = < 0x01 >;
				vsync-active = < 0x00 >;
				de-active = < 0x01 >;
				pixelclk-active = < 0x01 >;
				phandle = < 0x66 >;
			};
		};

		ports {
			#address-cells = < 0x01 >;
			#size-cells = < 0x00 >;

			port@0 {
				#address-cells = < 0x01 >;
				#size-cells = < 0x00 >;
				reg = < 0x00 >;
			};

			port@1 {
				#address-cells = < 0x01 >;
				#size-cells = < 0x00 >;
				reg = < 0x01 >;

				endpoint@0 {
					reg = < 0x00 >;
				};
			};
		};
	};

	drm_dp@2 {
		compatible = "telechips,drm-dp";
		status = "disabled";

		display-timings {
			native-mode = < 0x67 >;

			1920x720p60@0 {
				clock-frequency = < 0x541d340 >;
				hactive = < 0x780 >;
				vactive = < 0x2d0 >;
				hfront-porch = < 0x1e >;
				hback-porch = < 0x1e >;
				hsync-len = < 0x04 >;
				hsync-active = < 0x00 >;
				vback-porch = < 0x09 >;
				vfront-porch = < 0x0a >;
				vsync-len = < 0x02 >;
				vsync-active = < 0x00 >;
				de-active = < 0x01 >;
				pixelclk-active = < 0x01 >;
			};

			1920x720p60@1 {
				clock-frequency = < 0x677e240 >;
				hactive = < 0x780 >;
				vactive = < 0x2d0 >;
				hfront-porch = < 0x164 >;
				hback-porch = < 0x60 >;
				hsync-len = < 0x08 >;
				hsync-active = < 0x00 >;
				vback-porch = < 0x03 >;
				vfront-porch = < 0x24 >;
				vsync-len = < 0x01 >;
				vsync-active = < 0x00 >;
				de-active = < 0x01 >;
				pixelclk-active = < 0x01 >;
				phandle = < 0x67 >;
			};
		};

		ports {
			#address-cells = < 0x01 >;
			#size-cells = < 0x00 >;

			port@0 {
				#address-cells = < 0x01 >;
				#size-cells = < 0x00 >;
				reg = < 0x00 >;
			};

			port@1 {
				#address-cells = < 0x01 >;
				#size-cells = < 0x00 >;
				reg = < 0x01 >;

				endpoint@0 {
					reg = < 0x00 >;
				};
			};
		};
	};

	drm_dp@3 {
		compatible = "telechips,drm-dp";
		status = "disabled";

		display-timings {
			native-mode = < 0x68 >;

			1920x720p60@0 {
				clock-frequency = < 0x541d340 >;
				hactive = < 0x780 >;
				vactive = < 0x2d0 >;
				hfront-porch = < 0x1e >;
				hback-porch = < 0x1e >;
				hsync-len = < 0x04 >;
				hsync-active = < 0x00 >;
				vback-porch = < 0x09 >;
				vfront-porch = < 0x0a >;
				vsync-len = < 0x02 >;
				vsync-active = < 0x00 >;
				de-active = < 0x01 >;
				pixelclk-active = < 0x01 >;
			};

			1920x720p60@1 {
				clock-frequency = < 0x677e240 >;
				hactive = < 0x780 >;
				vactive = < 0x2d0 >;
				hfront-porch = < 0x164 >;
				hback-porch = < 0x60 >;
				hsync-len = < 0x08 >;
				hsync-active = < 0x00 >;
				vback-porch = < 0x03 >;
				vfront-porch = < 0x24 >;
				vsync-len = < 0x01 >;
				vsync-active = < 0x00 >;
				de-active = < 0x01 >;
				pixelclk-active = < 0x01 >;
				phandle = < 0x68 >;
			};
		};

		ports {
			#address-cells = < 0x01 >;
			#size-cells = < 0x00 >;

			port@0 {
				#address-cells = < 0x01 >;
				#size-cells = < 0x00 >;
				reg = < 0x00 >;
			};

			port@1 {
				#address-cells = < 0x01 >;
				#size-cells = < 0x00 >;
				reg = < 0x01 >;

				endpoint@0 {
					reg = < 0x00 >;
				};
			};
		};
	};

	drm_dummy@0 {
		compatible = "telechips,drm-dummy-dev";
		status = "disabled";
		connector_type = "LVDS";

		display-timings {
			native-mode = < 0x69 >;

			1920x720p60@0 {
				clock-frequency = < 0x541d340 >;
				hactive = < 0x780 >;
				vactive = < 0x2d0 >;
				hfront-porch = < 0x1e >;
				hback-porch = < 0x1e >;
				hsync-len = < 0x04 >;
				hsync-active = < 0x00 >;
				vback-porch = < 0x09 >;
				vfront-porch = < 0x0a >;
				vsync-len = < 0x02 >;
				vsync-active = < 0x00 >;
				de-active = < 0x01 >;
				pixelclk-active = < 0x01 >;
			};

			1920x720p60@1 {
				clock-frequency = < 0x677e240 >;
				hactive = < 0x780 >;
				vactive = < 0x2d0 >;
				hfront-porch = < 0x164 >;
				hback-porch = < 0x60 >;
				hsync-len = < 0x08 >;
				hsync-active = < 0x00 >;
				vback-porch = < 0x03 >;
				vfront-porch = < 0x24 >;
				vsync-len = < 0x01 >;
				vsync-active = < 0x00 >;
				de-active = < 0x01 >;
				pixelclk-active = < 0x01 >;
				phandle = < 0x69 >;
			};
		};

		ports {
			#address-cells = < 0x01 >;
			#size-cells = < 0x00 >;

			port@0 {
				#address-cells = < 0x01 >;
				#size-cells = < 0x00 >;
				reg = < 0x00 >;
			};
		};
	};

	drm_dummy@1 {
		compatible = "telechips,drm-dummy-dev";
		status = "disabled";
		connector_type = "LVDS";

		display-timings {
			native-mode = < 0x6a >;

			1920x720p60@0 {
				clock-frequency = < 0x541d340 >;
				hactive = < 0x780 >;
				vactive = < 0x2d0 >;
				hfront-porch = < 0x1e >;
				hback-porch = < 0x1e >;
				hsync-len = < 0x04 >;
				hsync-active = < 0x00 >;
				vback-porch = < 0x09 >;
				vfront-porch = < 0x0a >;
				vsync-len = < 0x02 >;
				vsync-active = < 0x00 >;
				de-active = < 0x01 >;
				pixelclk-active = < 0x01 >;
			};

			1920x720p60@1 {
				clock-frequency = < 0x677e240 >;
				hactive = < 0x780 >;
				vactive = < 0x2d0 >;
				hfront-porch = < 0x164 >;
				hback-porch = < 0x60 >;
				hsync-len = < 0x08 >;
				hsync-active = < 0x00 >;
				vback-porch = < 0x03 >;
				vfront-porch = < 0x24 >;
				vsync-len = < 0x01 >;
				vsync-active = < 0x00 >;
				de-active = < 0x01 >;
				pixelclk-active = < 0x01 >;
				phandle = < 0x6a >;
			};
		};

		ports {
			#address-cells = < 0x01 >;
			#size-cells = < 0x00 >;

			port@0 {
				#address-cells = < 0x01 >;
				#size-cells = < 0x00 >;
				reg = < 0x00 >;
			};
		};
	};

	drm_dummy@2 {
		compatible = "telechips,drm-dummy-dev";
		status = "disabled";
		connector_type = "LVDS";

		display-timings {
			native-mode = < 0x6b >;

			1920x720p60@0 {
				clock-frequency = < 0x541d340 >;
				hactive = < 0x780 >;
				vactive = < 0x2d0 >;
				hfront-porch = < 0x1e >;
				hback-porch = < 0x1e >;
				hsync-len = < 0x04 >;
				hsync-active = < 0x00 >;
				vback-porch = < 0x09 >;
				vfront-porch = < 0x0a >;
				vsync-len = < 0x02 >;
				vsync-active = < 0x00 >;
				de-active = < 0x01 >;
				pixelclk-active = < 0x01 >;
			};

			1920x720p60@1 {
				clock-frequency = < 0x677e240 >;
				hactive = < 0x780 >;
				vactive = < 0x2d0 >;
				hfront-porch = < 0x164 >;
				hback-porch = < 0x60 >;
				hsync-len = < 0x08 >;
				hsync-active = < 0x00 >;
				vback-porch = < 0x03 >;
				vfront-porch = < 0x24 >;
				vsync-len = < 0x01 >;
				vsync-active = < 0x00 >;
				de-active = < 0x01 >;
				pixelclk-active = < 0x01 >;
				phandle = < 0x6b >;
			};
		};

		ports {
			#address-cells = < 0x01 >;
			#size-cells = < 0x00 >;

			port@0 {
				#address-cells = < 0x01 >;
				#size-cells = < 0x00 >;
				reg = < 0x00 >;
			};
		};
	};

	drm_dummy@3 {
		compatible = "telechips,drm-dummy-dev";
		status = "disabled";
		connector_type = "LVDS";

		display-timings {
			native-mode = < 0x6c >;

			1920x720p60@0 {
				clock-frequency = < 0x541d340 >;
				hactive = < 0x780 >;
				vactive = < 0x2d0 >;
				hfront-porch = < 0x1e >;
				hback-porch = < 0x1e >;
				hsync-len = < 0x04 >;
				hsync-active = < 0x00 >;
				vback-porch = < 0x09 >;
				vfront-porch = < 0x0a >;
				vsync-len = < 0x02 >;
				vsync-active = < 0x00 >;
				de-active = < 0x01 >;
				pixelclk-active = < 0x01 >;
			};

			1920x720p60@1 {
				clock-frequency = < 0x677e240 >;
				hactive = < 0x780 >;
				vactive = < 0x2d0 >;
				hfront-porch = < 0x164 >;
				hback-porch = < 0x60 >;
				hsync-len = < 0x08 >;
				hsync-active = < 0x00 >;
				vback-porch = < 0x03 >;
				vfront-porch = < 0x24 >;
				vsync-len = < 0x01 >;
				vsync-active = < 0x00 >;
				de-active = < 0x01 >;
				pixelclk-active = < 0x01 >;
				phandle = < 0x6c >;
			};
		};

		ports {
			#address-cells = < 0x01 >;
			#size-cells = < 0x00 >;

			port@0 {
				#address-cells = < 0x01 >;
				#size-cells = < 0x00 >;
				reg = < 0x00 >;
			};
		};
	};

	drm_lvds_dual@0 {
		compatible = "telechips,drm-lvds-dual";
		status = "disabled";
		mode = < 0x00 >;
		phy-ports = < 0x02 0x03 >;
		data-mapping = "vesa-24";
		lane-main = < 0x04 0x00 0x03 0x02 0x01 >;
		lane-sub = < 0x01 0x02 0x03 0x00 0x04 >;
		vcm = < 0x4b0 >;
		vsw = < 0x1f4 >;
		blk-wait-time = < 0x104 >;

		display-timings {
			native-mode = < 0x6d >;

			1920x720p60@0 {
				clock-frequency = < 0x541d340 >;
				hactive = < 0x780 >;
				vactive = < 0x2d0 >;
				hfront-porch = < 0x1e >;
				hback-porch = < 0x1e >;
				hsync-len = < 0x04 >;
				hsync-active = < 0x00 >;
				vback-porch = < 0x09 >;
				vfront-porch = < 0x0a >;
				vsync-len = < 0x02 >;
				vsync-active = < 0x00 >;
				de-active = < 0x01 >;
				pixelclk-active = < 0x01 >;
			};

			1920x720p60@1 {
				clock-frequency = < 0x677e240 >;
				hactive = < 0x780 >;
				vactive = < 0x2d0 >;
				hfront-porch = < 0x164 >;
				hback-porch = < 0x60 >;
				hsync-len = < 0x08 >;
				hsync-active = < 0x00 >;
				vback-porch = < 0x03 >;
				vfront-porch = < 0x24 >;
				vsync-len = < 0x01 >;
				vsync-active = < 0x00 >;
				de-active = < 0x01 >;
				pixelclk-active = < 0x01 >;
				phandle = < 0x6d >;
			};
		};

		ports {
			#address-cells = < 0x01 >;
			#size-cells = < 0x00 >;

			port@0 {
				#address-cells = < 0x01 >;
				#size-cells = < 0x00 >;
				reg = < 0x00 >;
			};

			port@1 {
				#address-cells = < 0x01 >;
				#size-cells = < 0x00 >;
				reg = < 0x01 >;

				endpoint@0 {
					reg = < 0x00 >;
				};
			};
		};
	};

	drm_lvds_single@0 {
		compatible = "telechips,drm-lvds-single";
		status = "disabled";
		mode = < 0x01 >;
		phy-ports = < 0x00 >;
		data-mapping = "vesa-24";
		lane-main = < 0x01 0x02 0x03 0x00 0x04 >;
		vcm = < 0x4b0 >;
		vsw = < 0x190 >;

		display-timings {
			native-mode = < 0x6e >;

			1024x600p60 {
				clock-frequency = < 0x30d4000 >;
				hactive = < 0x400 >;
				vactive = < 0x258 >;
				hfront-porch = < 0x93 >;
				hback-porch = < 0x93 >;
				hsync-len = < 0x13 >;
				hsync-active = < 0x00 >;
				vback-porch = < 0x0a >;
				vfront-porch = < 0x19 >;
				vsync-len = < 0x02 >;
				vsync-active = < 0x00 >;
				de-active = < 0x01 >;
				pixelclk-active = < 0x01 >;
				phandle = < 0x6e >;
			};
		};

		ports {
			#address-cells = < 0x01 >;
			#size-cells = < 0x00 >;

			port@0 {
				#address-cells = < 0x01 >;
				#size-cells = < 0x00 >;
				reg = < 0x00 >;
			};

			port@1 {
				#address-cells = < 0x01 >;
				#size-cells = < 0x00 >;
				reg = < 0x01 >;

				endpoint@0 {
					reg = < 0x00 >;
				};
			};
		};
	};

	fb_dptx_v14 {
		compatible = "telechips,fb-dpv14-panel";
		status = "disabled";
		clocks = < 0x1e 0x14000504 0x1e 0x14000508 0x1e 0x1400050c 0x1e 0x14000518 >;
		clock-names = "disp0-clk\0disp1-clk\0disp2-clk\0disp3-clk";
		lcdc-mux-select = < 0x02 >;
		dp-idx = < 0x01 >;
		vic = < 0x00 0x404 >;
		blk-wait-time = < 0x104 >;

		ports {
			#address-cells = < 0x01 >;
			#size-cells = < 0x00 >;

			port@0 {
				#address-cells = < 0x01 >;
				#size-cells = < 0x00 >;
				reg = < 0x00 >;

				endpoint@0 {
					reg = < 0x00 >;
				};
			};
		};
	};

	fb@0 {
		compatible = "telechips,fb";
		status = "okay";
		clocks = < 0x47 0x120 >;
		memory-region = < 0x6f >;
		xres = < 0x780 >;
		yres = < 0x2d0 >;
		bpp = < 0x20 >;
		chroma-key = < 0x00 0x00 0x00 >;
		chroma-mkey = < 0xf8 0xfc 0xf8 >;
		mode = < 0x02 >;
		update-type = < 0x01 >;
		device-priority = < 0x01 >;
		telechips,disp = < 0x4b 0x102 >;
		telechips,wmixer = < 0x49 0x402 >;
		telechips,rdma = < 0x48 0x208 >;
		telechips,fbdc = < 0x70 0x1801 >;

		ports {
			#address-cells = < 0x01 >;
			#size-cells = < 0x00 >;

			port@0 {
				#address-cells = < 0x01 >;
				#size-cells = < 0x00 >;
				reg = < 0x00 >;

				endpoint {
					remote-endpoint = < 0x71 >;
					phandle = < 0x64 >;
				};
			};
		};
	};

	fb@1 {
		compatible = "telechips,fb";
		status = "disabled";
		clocks = < 0x47 0x120 >;
		memory-region;
		xres = < 0x780 >;
		yres = < 0x2d0 >;
		bpp = < 0x20 >;
		chroma-key = < 0x00 0x00 0x00 >;
		chroma-mkey = < 0xf8 0xfc 0xf8 >;
		mode = < 0x02 >;
		update-type = < 0x01 >;
		device-priority = < 0x01 >;
		telechips,disp = < 0x4b 0x100 >;
		telechips,wmixer = < 0x49 0x400 >;
		telechips,rdma = < 0x48 0x202 >;

		ports {
			#address-cells = < 0x01 >;
			#size-cells = < 0x00 >;

			port@0 {
				#address-cells = < 0x01 >;
				#size-cells = < 0x00 >;
				reg = < 0x00 >;

				endpoint {
				};
			};
		};
	};

	fb@2 {
		compatible = "telechips,fb";
		status = "disabled";
		clocks = < 0x47 0x120 >;
		memory-region;
		xres = < 0x780 >;
		yres = < 0x2d0 >;
		bpp = < 0x20 >;
		chroma-key = < 0x00 0x00 0x00 >;
		chroma-mkey = < 0xf8 0xfc 0xf8 >;
		mode = < 0x02 >;
		update-type = < 0x01 >;
		device-priority = < 0x01 >;
		telechips,disp = < 0x4b 0x102 >;
		telechips,wmixer = < 0x49 0x402 >;
		telechips,rdma = < 0x48 0x209 >;

		ports {
			#address-cells = < 0x01 >;
			#size-cells = < 0x00 >;

			port@0 {
				#address-cells = < 0x01 >;
				#size-cells = < 0x00 >;
				reg = < 0x00 >;

				endpoint {
				};
			};
		};
	};

	fb@3 {
		compatible = "telechips,fb";
		status = "disabled";
		clocks = < 0x47 0x120 >;
		memory-region;
		xres = < 0x780 >;
		yres = < 0x2d0 >;
		bpp = < 0x20 >;
		chroma-key = < 0x00 0x00 0x00 >;
		chroma-mkey = < 0xf8 0xfc 0xf8 >;
		mode = < 0x02 >;
		update-type = < 0x02 >;
		device-priority = < 0x00 >;
		no-kernel-logo = < 0x01 >;
		telechips,wdma = < 0x4c 0x705 >;
		telechips,wmixer = < 0x49 0x405 >;
		telechips,rdma = < 0x48 0x210 >;

		ports {
			#address-cells = < 0x01 >;
			#size-cells = < 0x00 >;

			port@0 {
				#address-cells = < 0x01 >;
				#size-cells = < 0x00 >;
				reg = < 0x00 >;

				endpoint {
				};
			};
		};
	};

	dpv14_tx@12400000 {
		compatible = "telechips,dpv14-tx";
		reg = < 0x00 0x12400000 0x00 0x100000 0x00 0x1b930000 0x00 0x78 0x00 0x1b936000 0x00 0x258 >;
		reg-names = "DDIBUS_BASE_ADD\0MICOM_SUB_SYSTEM_CONF\0PMU_BASE_ADD";
		interrupts = < 0x00 0x126 0x04 >;
		interrupt-names = "dp_hpd";
		clocks = < 0x1e 0x14000504 0x1e 0x14000508 0x1e 0x1400050c 0x1e 0x14000518 >;
		clock-names = "disp0-clk\0disp1-clk\0disp2-clk\0disp3-clk";
		pinctrl-names = "default\0sleep";
		pinctrl-0;
		pinctrl-1;
		sink_vcp_id = < 0x01 0x02 0x03 0x04 >;
		dp-slave-mode = < 0x01 >;
		status = "disabled";

		hw-config {
			aux-hysteresis = < 0x02 >;
		};
	};

	lvds_phy@1b940000 {
		compatible = "telechips,lvds_phy";
		reg = < 0x00 0x1b941000 0x00 0x400 0x00 0x1b941000 0x00 0x400 0x00 0x1b942800 0x00 0x400 0x00 0x1b942c00 0x00 0x400 0x00 0x1b940000 0x00 0x400 >;
		phandle = < 0x59 >;
	};

	vpu_dev_mgr {
		compatible = "telechips,vpu_dev_mgr";
		reg = < 0x00 0x15000000 0x00 0x4000 >;
		interrupts = < 0x00 0x86 0x04 >;
		clocks = < 0x11 0x15280000 0x11 0x15280004 0x72 0x141 0x72 0x142 >;
		resets = < 0x73 0x141 0x73 0x142 >;
		reset-names = "xoda_bus\0xoda_core";
		status = "disabled";
	};

	jpu_dev_mgr {
		compatible = "telechips,jpu_dev_mgr";
		reg = < 0x00 0x15180000 0x00 0x1000 >;
		interrupts = < 0x00 0x87 0x04 >;
		clocks = < 0x11 0x15280000 0x72 0x140 >;
		resets = < 0x73 0x140 >;
		reset-names = "jpeg";
		status = "disabled";
	};

	vpu_4k_d2_dev_mgr {
		compatible = "telechips,vpu_4k_d2_dev_mgr";
		reg = < 0x00 0x15200000 0x00 0xa000 >;
		interrupts = < 0x00 0x88 0x04 >;
		clocks = < 0x11 0x15280000 0x11 0x15280008 0x11 0x1528000c 0x72 0x143 0x72 0x144 >;
		resets = < 0x73 0x143 0x73 0x144 >;
		reset-names = "hevc_bus\0hevc_core";
		status = "disabled";
	};

	vpu_hevc_enc_dev_mgr {
		compatible = "telechips,vpu_hevc_enc_dev_mgr";
		reg = < 0x00 0x15300000 0x00 0xa000 0x00 0x15100000 0x00 0x1000 >;
		interrupts = < 0x00 0x89 0x04 >;
		clocks = < 0x11 0x15280000 0x11 0x15280034 0x11 0x15280038 0x72 0x145 >;
		resets = < 0x73 0x145 >;
		reset-names = "hevc_encoder";
		status = "disabled";
	};

	hevc_dev_mgr {
		compatible = "telechips,hevc_dev_mgr";
		status = "disabled";
	};

	gpu@0x10100000 {
		compatible = "imagination,powerVR-9XTP";
		status = "okay";
		reg = < 0x00 0x10100000 0x00 0x10000 0x00 0x10010000 0x00 0x30 >;
		interrupts = < 0x00 0x7b 0x04 0x00 0x7c 0x04 >;
		interrupt-names = "GPU";
		clocks = < 0x74 0x10000000 >;
		clock-names = "9XTP_clk";
	};

	tcc_cap_media {
		compatible = "telechips,tcc-cap-media";
		phandle = < 0x7d >;
	};

	mipi_wrap {
		#address-cells = < 0x02 >;
		#size-cells = < 0x02 >;
		compatible = "simple-bus";
		ranges;
		mipi-chmux-0 = < 0x00 >;
		mipi-chmux-1 = < 0x00 >;
		mipi-chmux-2 = < 0x00 >;
		mipi-chmux-3 = < 0x00 >;
		mipi-chmux-4 = < 0x00 >;
		mipi-chmux-5 = < 0x00 >;
		mipi-chmux-6 = < 0x00 >;
		mipi-chmux-7 = < 0x00 >;
		isp0-bypass = < 0x01 >;
		isp1-bypass = < 0x01 >;
		isp2-bypass = < 0x01 >;
		isp3-bypass = < 0x01 >;

		mipi_csi2_0@1bc00800 {
			compatible = "telechips,tcc805x-mipi-csi2";
			status = "okay";
			reg = < 0x00 0x1bc00800 0x00 0x120 0x00 0x1bc00a00 0x00 0x5c 0x00 0x1bc00000 0x00 0x14 0x00 0x1bc00400 0x00 0x120 >;
			reg-names = "csi\0gdb\0ckc\0cfg";
			clock-frequency = < 0x23c34600 >;
			interrupts = < 0x00 0x9e 0x04 0x00 0x9f 0x04 >;
			interrupt-names = "csi\0gdb";

			ports {
				#address-cells = < 0x01 >;
				#size-cells = < 0x00 >;

				port@0 {
					reg = < 0x00 >;

					endpoint {
						remote-endpoint = < 0x75 >;
						io-direction = "input";
						num-channel = < 0x04 >;
						interleave-mode = < 0x03 >;
						hs-settle = < 0x11 >;
						data-lanes = < 0x01 0x02 0x03 0x04 >;
						phandle = < 0x30 >;
					};
				};

				port@1 {
					reg = < 0x01 >;

					endpoint {
						remote-endpoint = < 0x76 >;
						io-direction = "output";
						channel = < 0x00 >;
						pixel-mode = < 0x01 >;
						phandle = < 0x83 >;
					};
				};

				port@2 {
					reg = < 0x02 >;

					endpoint {
						remote-endpoint = < 0x77 >;
						io-direction = "output";
						channel = < 0x01 >;
						pixel-mode = < 0x01 >;
						phandle = < 0x85 >;
					};
				};

				port@3 {
					reg = < 0x03 >;

					endpoint {
						remote-endpoint = < 0x78 >;
						io-direction = "output";
						channel = < 0x02 >;
						pixel-mode = < 0x01 >;
						phandle = < 0x87 >;
					};
				};

				port@4 {
					reg = < 0x04 >;

					endpoint {
						remote-endpoint = < 0x79 >;
						io-direction = "output";
						channel = < 0x03 >;
						pixel-mode = < 0x01 >;
						phandle = < 0x89 >;
					};
				};
			};
		};

		mipi_csi2_1@1bc00c00 {
			compatible = "telechips,tcc805x-mipi-csi2";
			status = "disabled";
			reg = < 0x00 0x1bc00c00 0x00 0x120 0x00 0x1bc00e00 0x00 0x5c 0x00 0x1bc00000 0x00 0x14 0x00 0x1bc00400 0x00 0x120 >;
			reg-names = "csi\0gdb\0ckc\0cfg";
			clock-frequency = < 0x23c34600 >;
			interrupts = < 0x00 0xa0 0x04 0x00 0xa1 0x04 >;
			interrupt-names = "csi\0gdb";
		};

		isp0@1bc80000 {
			compatible = "telechips,tcc805x-isp";
			status = "disabled";
			reg = < 0x00 0x1bc80000 0x00 0x10000 0x00 0x1bc93800 0x00 0xc800 0x00 0x1bc00400 0x00 0x120 0x00 0x1bc90000 0x00 0x3800 >;
			reg-names = "isp_base\0mem_base\0cfg_base\0scene_data_base";
		};

		isp1@1bca0000 {
			compatible = "telechips,tcc805x-isp";
			status = "disabled";
			reg = < 0x00 0x1bca0000 0x00 0x10000 0x00 0x1bcb3800 0x00 0xc800 0x00 0x1bc00400 0x00 0x120 0x00 0x1bcb0000 0x00 0x3800 >;
			reg-names = "isp_base\0mem_base\0cfg_base\0scene_data_base";
		};

		isp2@1bcc0000 {
			compatible = "telechips,tcc805x-isp";
			status = "disabled";
			reg = < 0x00 0x1bcc0000 0x00 0x10000 0x00 0x1bcd3800 0x00 0xc800 0x00 0x1bc00400 0x00 0x120 0x00 0x1bcd0000 0x00 0x3800 >;
			reg-names = "isp_base\0mem_base\0cfg_base\0scene_data_base";
		};

		isp3@1bce0000 {
			compatible = "telechips,tcc805x-isp";
			status = "disabled";
			reg = < 0x00 0x1bce0000 0x00 0x10000 0x00 0x1bcf3800 0x00 0xc800 0x00 0x1bc00400 0x00 0x120 0x00 0x1bcf0000 0x00 0x3800 >;
			reg-names = "isp_base\0mem_base\0cfg_base\0scene_data_base";
		};
	};

	videoinput0 {
		compatible = "telechips,video-input";
		status = "okay";
		clocks = < 0x47 0x120 >;
		rdma = < 0x48 0x210 >;
		vin = < 0x7a 0xa00 >;
		viqe = < 0x4d 0x1001 >;
		deintls = < 0x7b 0x800 >;
		scaler = < 0x4e 0x502 >;
		wmixer = < 0x49 0x405 >;
		wdma = < 0x4c 0x705 >;
		fifo = < 0x7c 0x900 >;
		mediadev = < 0x7d >;
		cifport = < 0x7e 0x00 >;
		use_pgl = < 0x00 >;
		memory-region = < 0x00 0x7f 0x80 0x00 >;

		port {

			endpoint {
				remote-endpoint = < 0x81 >;
				io-direction = "input";
				stream-enable = < 0x00 >;
				flush-vsync = < 0x00 >;
				phandle = < 0x2a >;
			};
		};
	};

	videoinput1 {
		compatible = "telechips,video-input";
		status = "disabled";
		clocks = < 0x47 0x120 >;
		rdma = < 0x48 0x211 >;
		vin = < 0x7a 0xa02 >;
		viqe = < 0x4d 0x1001 >;
		deintls = < 0x7b 0x800 >;
		scaler = < 0x4e 0x504 >;
		wmixer = < 0x49 0x406 >;
		wdma = < 0x4c 0x707 >;
		fifo = < 0x7c 0x900 >;
		mediadev = < 0x7d >;
	};

	videoinput2 {
		compatible = "telechips,video-input";
		status = "disabled";
		clocks = < 0x47 0x120 >;
		rdma = < 0x48 0x20d >;
		vin = < 0x7a 0xa04 >;
		viqe = < 0x4d 0x1001 >;
		deintls = < 0x7b 0x800 >;
		scaler = < 0x4e 0x505 >;
		wmixer = < 0x49 0x403 >;
		wdma = < 0x4c 0x703 >;
		fifo = < 0x7c 0x900 >;
		mediadev = < 0x7d >;
	};

	videoinput3 {
		compatible = "telechips,video-input";
		status = "disabled";
		clocks = < 0x47 0x120 >;
		rdma = < 0x48 0x20f >;
		vin = < 0x7a 0xa06 >;
		viqe = < 0x4d 0x1001 >;
		deintls = < 0x7b 0x800 >;
		scaler = < 0x4e 0x506 >;
		wmixer = < 0x49 0x404 >;
		wdma = < 0x4c 0x704 >;
		fifo = < 0x7c 0x900 >;
		mediadev = < 0x7d >;
	};

	videoinput4 {
		compatible = "telechips,video-input";
		status = "okay";
		clocks = < 0x47 0x120 >;
		vin = < 0x7a 0xa08 >;
		wdma = < 0x4c 0x709 >;
		fifo = < 0x7c 0x900 >;
		mediadev = < 0x7d >;
		cifport = < 0x7e 0x05 >;
		memory-region = < 0x00 0x00 0x82 0x00 >;

		port {

			endpoint {
				remote-endpoint = < 0x83 >;
				io-direction = "input";
				stream-enable = < 0x01 >;
				flush-vsync = < 0x01 >;
				phandle = < 0x76 >;
			};
		};
	};

	videoinput5 {
		compatible = "telechips,video-input";
		status = "okay";
		clocks = < 0x47 0x120 >;
		vin = < 0x7a 0xa0a >;
		wdma = < 0x4c 0x70a >;
		fifo = < 0x7c 0x900 >;
		mediadev = < 0x7d >;
		cifport = < 0x7e 0x06 >;
		memory-region = < 0x00 0x00 0x84 0x00 >;

		port {

			endpoint {
				remote-endpoint = < 0x85 >;
				io-direction = "input";
				stream-enable = < 0x01 >;
				flush-vsync = < 0x01 >;
				phandle = < 0x77 >;
			};
		};
	};

	videoinput6 {
		compatible = "telechips,video-input";
		status = "okay";
		clocks = < 0x47 0x120 >;
		vin = < 0x7a 0xa0c >;
		wdma = < 0x4c 0x70b >;
		fifo = < 0x7c 0x900 >;
		mediadev = < 0x7d >;
		cifport = < 0x7e 0x07 >;
		memory-region = < 0x00 0x00 0x86 0x00 >;

		port {

			endpoint {
				remote-endpoint = < 0x87 >;
				io-direction = "input";
				stream-enable = < 0x01 >;
				flush-vsync = < 0x01 >;
				phandle = < 0x78 >;
			};
		};
	};

	videoinput7 {
		compatible = "telechips,video-input";
		status = "okay";
		clocks = < 0x47 0x120 >;
		vin = < 0x7a 0xa0e >;
		wdma = < 0x4c 0x70c >;
		fifo = < 0x7c 0x900 >;
		mediadev = < 0x7d >;
		cifport = < 0x7e 0x08 >;
		memory-region = < 0x00 0x00 0x88 0x00 >;

		port {

			endpoint {
				remote-endpoint = < 0x89 >;
				io-direction = "input";
				stream-enable = < 0x01 >;
				flush-vsync = < 0x01 >;
				phandle = < 0x79 >;
			};
		};
	};

	camipc0 {
		compatible = "telechips,camipc";
		status = "okay";
		device-name = "camipc_main";
		protocol = "CAM0";
		tcc_ipi = < 0x4a >;
	};

	camipc1 {
		compatible = "telechips,camipc";
		status = "okay";
		device-name = "camipc_micom";
		protocol = "CAM1";
		tcc_ipi = < 0x3d >;
	};
};
